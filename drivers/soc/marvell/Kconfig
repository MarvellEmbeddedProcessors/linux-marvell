## drivers/soc/marvell/Kconfig
```kconfig
# SPDX-License-Identifier: GPL-2.0-only
#
# MARVELL SoC drivers
#

menu "Marvell SoC drivers"

config OCTEONTX2_SDP_PF
	tristate "OcteonTX2 SDP PF driver"
	depends on ARM64 && PCI && OCTEONTX2_AF && OCTEONTX2_MBOX
	default y
	help
	  This driver configures the SDP RVU PF when OcteonTx is in PCIe EndPoint
	  mode. It sets up the SDP rings  and the VFs to be used in packet transfer
	  using the NIX block.

	  To compile this as a module choose M here.

config MRVL_PHY_DIAGNOSTICS
	tristate "Marvell PHY diagnostics debugfs driver"
	default m
	depends on DEBUG_FS
	help
	  Select this option if you want an additional interface for
	  extended diagnostics functions for the PHY. This complements
	  functionality offered by ethtool. Requires PHY driver support in ATF.

config HW_CSR_ACCESS
	tristate "Access HW Device Config Space"
	depends on OCTEONTX2_AF
	default m
	help
	  provides an interface which enables user space utility to read from or to write
	  to HW Device Config Space Registers, Contexts, Memory.

config OCTEONTX2_DPI_PF
	tristate "OcteonTX2 DPI-DMA PF driver"
	depends on ARM64 && PCI
	default m
	help
	  Select this option to enable DPI PF driver support.
	  DPI (DMA packet interface) provides DMA support for MAC.
	  This driver intializes DPI PF device and enables VFs for supporting
	  different types of DMA transfers.

config MARVELL_PTM_EP
	tristate "Marvell PCIe PTM EP"
	default m
	help
	  Provides PTM requestor(EP) support. The driver provides interface for
	  triggering and capturing time.

	  To compile this as a module, choose M here. The module will be called
	  mrvl-ptm-ep.

config MARVELL_CN10K_SERDES_DIAGNOSTICS
	tristate "Marvell SerDes diagnostics debugfs driver"
	default m
	depends on DEBUG_FS
	help
	  Select this option if you want to enable SerDes diagnostics
	  interface for performing PRBS, setting Loopback mode or
	  reading/writing Tx/Rx tuning parameters.

config MVMDIO_UIO
	tristate "Marvell MDIO interface driver"
	  default m
	select MDIO_THUNDER
	help
	  Select this option if you want to provide an interface for userspace
	  PHY drivers to access Marvell's MDIO bus.

config OCTEONTX2_GHES_BERT
	bool "OcteonTX2 GHES Boot Error Record support"
	depends on ARM64 && ACPI_APEI
	default n
	help
	  Select this option to enable reporting of fatal Marvell GHES
	  errors on subsequent Linux boot.  Normally, fatal errors will
	  reset the system.  Enabling support here will allow such errors
	  to be reported when Linux is started again.

config OCTEONTX2_EINJ
	tristate "OcteonTX2 ECC Injection"
	help
	  Provides support for error injection to OcteonTX2
	  memory controllers (LMC) and cache blocks.
	  This facilitates testing of the memory controller RAS features and
	  is intended to be used by test personnel when conducting system tests.
	  To compile this as a module, choose M here. The module will be
	  called otx2-einj.
	  Unless testing, say N here.

config OCTEONTX2_GHES
	bool "OcteonTX2 GHES support"
	depends on ARM64 && ACPI_APEI
	default n
	help
	  Select this option to enable Marvell GHES support. This will
	  init and enable the MSI-X interrupts for LMC, MDC and MCC.
	  This config will also make sure that this is enabled only
	  for ARM64 platforms.

config MARVELL_CN10K_EINJ
	tristate "CN10K ECC Injection"
	depends on ARM64 && ACPI_APEI
	default n
	help
	  Provides support for error injection to CN10K
	  Pseudo-fault Generation processor error,
	  dram memory subsystem (DSS).
	  This facilitates testing of the memory controller RAS features and
	  is intended to be used by test personnel when conducting system tests.
	  To compile this as a module, choose M here. The module will be
	  called cn10k-einj.
	  Unless testing, say N here.

endmenu
```
