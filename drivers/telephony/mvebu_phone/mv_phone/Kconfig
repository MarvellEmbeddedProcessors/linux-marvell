## drivers/telephony/mvebu_phone/mv_phone/Kconfig
```kconfig
menu "SoC Telephony support"
	depends on MV_INCLUDE_TDM

	comment "See under:  Staging drivers -> Telephony support -> Marvell Telephony Options"

endmenu
```
