## Documentation/devicetree/bindings/mmc/sdhci-xenon.txt
```
* Marvell sdhci-xenon controller

This file documents differences between the core properties in mmc.txt
and the properties used by the sdhci-xenon drivers.

Required properties:
- compatible: Should be "marvell,xenon-sdhci".
- reg:
  one register area for the SDHCI registers.
- interrupts-extended: interrupt number and attributes
- clocks: array of clocks required for SDHCI.
- eMMC Speed Mode:
  If the SDHC slot in use is implemented to connect an eMMC
  card, three  speed modes in below should be explicitly set.
  - mmc-ddr-1_8v: whether support eMMC DDR mode by 1.8 voltage.
  - mmc-hs200-1_8v: whether support eMMC high speed 200 mode by 1.8 voltage.
  - mmc-hs400-1_8v: whether support eMMC high speed 400 mode by 1.8 voltage.
  Besides, since Xenon cannot support 1.2v, three speed modes in below should not be set.
  - mmc-ddr-1_2v: whether support eMMC DDR mode by 1.2 voltage.
  - mmc-hs200-1_2v:  whether support eMMC high speed 200 mode by 1.2 voltage.
  - mmc-hs400-1_2v: whether support eMMC high speed 400 mode by 1.2 voltage.
  If the SDHC slot is for SD/SDIO, eMMC speed mode should not be set.
- Slot Index
  Xenon can support multiple slots in a single IP. Each SDHC
  slot has its own setting bits.
  The specific slot index in Xenon IP should be provided.
  - xenon,slotno = <slot_index>;
- bus-width: max bus width in unit of bit, normally should be 1 bit, 4 bits or 8 bits
- tuning-count: tuning shift.

Optional properties:
- re-tuning counter
  Tuning counter is only necessary in the speed modes which require re-tuning, such as H200, SDR104 and SDR50.
  In Linux driver, the re-tuning interval will be 2 ^ (Tuning Counter - 1) seconds.
  Xenon SDHC usually doesn't provide re-tuning counter in capability register 3 bit[11:8], thus need set it in driver.
  This property provides the re-tuning counter.
  - xenon,tuning-count = <count>;
  The valid range of Tuning Counter on Xenon SDHC is [1, 0xE].
  0xF is the default value of Capabilities Register 3 bit[11:8] on Xenon SDHC, which indicates that the Tuning
  Counter should be achieved through another source.
  The selection of Tuning Counter value depends on the board timing and environment.
  More quickly the board timing varies with environment change, more frequently SDHC should execute re-tuning.
  The term board timing also includes the timing characteristic of eMMC/SD/SDIO card.
  If have no idea what value should set, just remove this property in DT file.
  If this property is not set, default re-tuning counter will be set to 0x9 in driver.
- xenon,emmc: whether only used for eMMC mode(does not support SD)
  If the SDHC_SYS_CFG_INFO register (Offset 0x0104) can clearly indicate that the current slot only supports eMMC, this property is optional.
  However, if the SDHC_SYS_CFG_INFO register shows that the current slot can also support SD/SDIO besides of eMMC, this property is mandatory.
  It informs driver that the current slot is used for eMMC.
  If this property is not set, current slot will be used for SD/SDIO.
- non-removable: whether card is non-removable.
- auto-cmd12: whether cmd12 is sent automatically.
Example:

sdhci0: sdhci@D8000 {
	compatible = "marvell,xenon-sdhci";
	reg = <0xD8000 0x300>;
	interrupts-extended = <&gic GIC_SPI 26 IRQ_TYPE_LEVEL_HIGH>;
	mmc-ddr-1_8v;
	mmc-hs200-1_8v;
	mmc-hs400-1_8v;
	xenon,slotno = <0>;
	xenon,emmc;
	non-removable;
	bus-width = <8>;
	auto-cmd12;
	tuning-count = <6>;
	status = "disabled";
};
```

## Documentation/devicetree/bindings/mtd/gd5f-nand.txt
```
GigaDevice 4Gb SPI NAND flash

Required properties:
- compatible: "gigadevice,gd5f"
- reg: SPI chip select line
- spi-max-frequency : maximum frequency of the SPI bus the chip can operate at


gd5f: spi@18101000 {
	compatible = "gigadevice,gd5f";
	reg = <1>; /* Chip select 1 */
	spi-max-frequency = <6250000>;
};
```

## Documentation/devicetree/bindings/mtd/mvebu_nfc.txt
```
* Marvell HAL based Nand Flash Controller driver device tree bindings

Required properties:

- compatible:			Should be "marvell,armada-nand"
- reg:				The register base for the controller
- interrupts:			The interrupt to map
- #address-cells/#size-cells:	Set to <1> or <2> if the node includes partitions,
				for more details see partition.txt file from
				this folder
- clocks:			Set clock that runs the controller
- clock-frequency		SoC's Tclk frequency
- nfc,nfc-dma			'0'/'1' for disable/enable DMA mode. Set always
				to '0' - DMA mode not supported
- nfc,nfc-width			Bus width - 8/16 bits
- nfc,ecc-type			ECC mode options. Possible values:
				0 - 1 bit
				1 - 4 bit
				2 - 8 bit
				3 - 12 bit
				4 - 16 bit
				5 - disable ECC
- nfc,num-cs			Chip-select

Example:
nfc: nand@d0000 {
	compatible = "marvell,armada-nand";
	interrupts = <0 84 0x4>;
	reg = <0xd0000 0x400>;
	clocks = <&coredivclk 0>;

	#address-cells = <1>;
	#size-cells = <1>;
	clock-frequency = <200000000>;
	status = "okay";

	nfc,nfc-mode  = "normal";
	nfc,nfc-dma   = <0>;
	nfc,nfc-width = <8>;
	nfc,ecc-type  = <1>;
	nfc,num-cs    = <1>;

	mtd0@00000000 {
		label = "U-Boot";
		reg = <0x00000000 0x00600000>;
		read-only;
	};

	mtd1@00080000 {
		label = "uImage";
		reg = <0x00600000 0x00400000>;
		read-only;
	};

	mtd2@00140000 {
		label = "Root";
		reg = <0x00a00000 0x3f600000>;
	};
};
```

## Documentation/devicetree/bindings/net/dsa/dsa-mvmdio.txt
```
Marvell PHY or Switch Register Access Device Tree Bindings
----------------------------------------------------------

Required properties:
- compatible	: Should be "marvell,dsa-mvmdio"
- reg		: Contains single field, that is switch's smi address when the
		  switch is in multichip addressing mode. It should be 0 when no
		  switch is connected or switch is in single-chip addressing mode.
- mii-bus	: handle to mdio node.
- xmii-bus	: handle to xmdio node.

Example:
	mdio: mdio@12a200 {
		#address-cells = <1>;
		#size-cells = <0>;
		ethernet-phy@0 {
			reg = <0>;
		};
	};
	xmdio: mdio@15b000 {
		#address-cells = <1>;
		#size-cells = <0>;
		ethernet-phy@0 {
			compatible = "ethernet-phy-ieee802.3-c45";
			reg = <0>;
		};
	};
	dsa_mvmdio {
		compatible = "marvell,dsa-mvmdio";
		status = "okay";
		reg = <3>;
		mii-bus = <&mdio>;
		xmii-bus = <&xmdio>;
	};
```

## Documentation/devicetree/bindings/net/marvell-armada-370-neta.txt
```
* Marvell Armada 370 / Armada XP / Armada 3700 Ethernet Controller (NETA)

Required properties:
- compatible: could be one of the followings
	"marvell,armada-370-neta"
	"marvell,armada-xp-neta"
	"marvell,armada3700-neta"
- reg: address and length of the register set for the device.
- interrupts: interrupt for the device
- phy-mode: See ethernet.txt file in the same directory
- clocks: a pointer to the reference clock for this device.

Optional properties:
- phy: See ethernet.txt file in the same directory.
- fixed-link: See fixed-link.txt file in the same directory.
- tx-csum-limit: maximum mtu supported by port that allow TX checksum.
  Value is presented in bytes. If not used, by default 1600B is set for
  "marvell,armada-370-neta" and 9800B for others.

Optional properties (valid only for Armada XP/38x/3700):

- buffer-manager: a phandle to a buffer manager node. Please refer to
  Documentation/devicetree/bindings/net/marvell-neta-bm.txt
- bm,pool-long: ID of a pool, that will accept all packets of a size
  higher than 'short' pool's threshold (if set) and up to MTU value.
  Obligatory, when the port is supposed to use hardware
  buffer management.
- bm,pool-short: ID of a pool, that will be used for accepting
  packets of a size lower than given threshold. If not set, the port
  will use a single 'long' pool for all packets, as defined above.
- phys: the serdes PHY associated to this device. Currently the property
  is only used by armada-3700 for SGMII interface.
  Format: <comphy_parent lane_number lane_type>.
- phy-names: the name of dedicated serdes indicated by above property of phys.

Example:

ethernet@70000 {
	compatible = "marvell,armada-370-neta";
	reg = <0x70000 0x2500>;
	interrupts = <8>;
	clocks = <&gate_clk 4>;
	tx-csum-limit = <9800>
	status = "okay";
	phy = <&phy0>;
	phy-mode = "rgmii-id";
	buffer-manager = <&bm>;
	bm,pool-long = <0>;
	bm,pool-short = <1>;
};

Example with serdes PHY:
	eth1: ethernet@40000 {
	compatible = "marvell,armada3700-neta";
	reg = <0x40000 0x4000>;
	interrupts = <GIC_SPI 45 IRQ_TYPE_LEVEL_HIGH>;
	mac-address = [00 50 43 01 02 03];
	clocks = <&sgateclk 4>;
	status = "okay";
	phy-mode = "sgmii";
	phy = <&phy1>;
	buffer-manager = <&bm>;
	bm,pool-long = <0>;
	bm,pool-short = <1>;
	phys = <&a3700_comphy 1 COMPHY_SGMII1>;
	phy-names = "comphy";
};
```

## Documentation/devicetree/bindings/net/marvell-net_complex.txt
```
* Marvell NSS Complex

Required properties:

- compatible: should be "marvell,armada-390-nss_complex"
- reg: include target and attribute for CPU window
       and addresses and length of the register sets for the device.

Example:

nss_complex {
        compatible = "marvell,armada-390-nss_complex";
        status = "disabled";
        reg = <MBUS_ID(0xf0, 0x01) 0x18200 0x100>,     /* netcomplex_misc */
              <MBUS_ID(0xf0, 0x01) 0x18300 0x200>,     /* netcomplex_phy */
              <MBUS_ID(0xf0, 0x01) 0x18a00 0x1000>,    /* netcomplex_base */
              <MBUS_ID(0xf0, 0x01) 0x0 0x100000>;      /* AXI bus */
};
```

## Documentation/devicetree/bindings/net/marvell-phy.txt
```
Marvell E2110 PHY supports 10M/100M/1G/2.5G/5G base-t and has more setup
bindings in addition to the standard PHY bindings. For undescribed properties,
please refer to Documentation/devicetree/bindings/net/phy.txt.

Compatible: "ethernet-phy-ieee802.3-c45"

Optional Properties:

- marvell,c45-reg-init :
  one of more sets of 4 cells to overwrite initial register value
  1st: the MDIO Manageable Device (MMD) address
  2nd: the second a register address within the MMD
  3rd: the third cell contains a mask to be ANDed with the existing
       register value
  4th: ORed with he result to yield the new register value.
  If the third cell has a value of zero, no read of the existing value is
  performed.

Example:
	phy0: ethernet-phy@0 {
		compatible = "ethernet-phy-ieee802.3-c45";
		reg = <0>;
		max-speed = <5000>;

		/* setup the lane swap */
		marvell,c45-reg-init = <1 0xc000 0xfffe 0x1>;
        };
```

## Documentation/devicetree/bindings/net/marvell-pp2.txt
```
* Marvell Armada 375 Ethernet Controller (PPv2)

Required properties - common part:
- compatible: should be "marvell,armada-375-pp2"
- reg: addresses and length of the register sets for the device.
  Minimum 3 sets are required:
	- common controller registers
	- LMS registers
	- GbE MAC0 registers
	- GbE MAC1 registers
	- Other port's registers (the driver enables extending the list
	  with another GbE MAC's or PON port in future)
- phy-mode: the interface between the SoC and the PHY (a string that
  of_get_phy_mode() can understand)
- clocks: a pointer to the reference clocks for this device, consequently:
	- main Packet Processor clock
	- GOP clock
- clock-names: names of used clocks

The Ethernet/PON ports are represented by their subnodes. The presence of
at least one is required. The order of the subnodes is not important,
however related register sets have to be declared in the common part
accordingly.

Required properties - port part:
- interrupts: port interrupt id
- port-id: port is recognized by it's id field which should fit predefined
  values in HW, e.g. ethernet MACs (id=0/1), loopback (id=2)
- phy-mode: the interface between the SoC and the PHY (a string that
  of_get_phy_mode() can understand)

Optional properties - port part:

- marvell,loopback: set GMAC to loopback mode
- phy: a phandle to a phy node defining the PHY address (as the reg
  property, a single integer). Note: if this property isn't present,
  then fixed link is assumed, and the 'fixed-link' property is
  mandatory.

Examples:

pp2@f0000 {
	compatible = "marvell,armada-375-pp2";
	reg = <0xf0000 0xa000>,
	      <0xc0000 0x3060>,
	      <0xc4000 0x100>,
	      <0xc5000 0x100>;
	clocks = <&gateclk 3>, <&gateclk 19>;
	clock-names = "pp_clk", "gop_clk";
	status = "ok";

	eth0: ethernet@c4000 {
		interrupts = <GIC_SPI 37 IRQ_TYPE_LEVEL_HIGH>;
		port-id = <0>;
		status = "ok";
		phy = <&phy0>;
		phy-mode = "gmii";
	};

	eth1: ethernet@c5000 {
		interrupts = <GIC_SPI 41 IRQ_TYPE_LEVEL_HIGH>;
		port-id = <1>;
		status = "ok";
		phy = <&phy3>;
		phy-mode = "gmii";
	};
};
```
