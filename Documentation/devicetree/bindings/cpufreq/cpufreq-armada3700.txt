## Documentation/devicetree/bindings/cpufreq/cpufreq-armada3700.txt
```
Armada37XX cpufreq driver
-------------------------

Armada37XX SoC cpufreq driver for CPU frequency scaling.

Required properties:
- interrupts: Interrupt to know the completion of cpu frequency change.
- clocks: CPU core clock to get the base CPU frequency.

Optional properties:
- clock-latency: Clock monitor latency in microsecond.

All the required listed above must be defined under node cpufreq.

Example:
--------
    cpufreq@14000 {
            compatible = "marvell,armada-3700-cpufreq";
            reg = <0x14000 0x1000>;
            interrupts = <GIC_SPI 128 IRQ_TYPE_LEVEL_HIGH>;
            clock-latency = <1000>;
            clocks = <&core_clk 0>;
    }
```

## Documentation/devicetree/bindings/crypto/inside_secure_eip.txt
```
Inside-secure EIP197/97 Cryptographic Engines And Security Accelerator
======================================================================

The EIP197/97 is a hybrid packet engine designed to off-load a security
host processor to improve the speed of IPsec ESP, IPsec AH, SRTP, SSL, TLS,
DTLS and MACsec protocol operations.

Required properties:
--------------------
- compatible	  : Should be "inside-secure,safexcel-eip197" " for EIP197 or
			      "inside-secure,safexcel-eip97" for EIP97.
- reg		  : Base physical address of the engine and length
		    of memory mapped region.
- interrupts	  : A list of interrupts required for EIP engine.
- interrupt-names : Names of the interrupts listed in interrupts property.
- clocks	  : Reference to the crypto engine clocks (Only for EIP197).
- dma-coherent	  : Present if dma operations are coherent.
- dma-bus-width   : DMA address bus width.
- cell-index	  : Should contain the EIP197 engine ID.
		    For Example, in Marvell Armada 8040, there are 2 engines (one on each CP).
                    cell-index will be 0 for CP0 and  1 for CP1.

Examples:
---------
	eip197@800000 {
		compatible = "inside-secure,safexcel-eip197";
		reg = <0x800000 0x200000>;
		interrupts = <ICU_GRP_REI 87 IRQ_TYPE_LEVEL_HIGH>,
			     <ICU_GRP_NSR 88 IRQ_TYPE_LEVEL_HIGH>,
			     <ICU_GRP_NSR 89 IRQ_TYPE_LEVEL_HIGH>,
			     <ICU_GRP_NSR 90 IRQ_TYPE_LEVEL_HIGH>,
			     <ICU_GRP_NSR 91 IRQ_TYPE_LEVEL_HIGH>,
			     <ICU_GRP_NSR 92 IRQ_TYPE_LEVEL_HIGH>;
		interrupt-names = "eip_addr", "ring0", "ring1",
				  "ring2", "ring3", "eip_out";
		clocks = <&cpm_syscon0 1 26>;
		dma-coherent;
		dma-bus-width = <40>;
		cell-index = <0>;
		status = "disabled";
	};

	eip97: eip97@90000 {
		compatible = "inside-secure,safexcel-eip97";
		reg = <0x90000 0x20000>;
		interrupt-names = "eip_out", "ring0", "ring1",
				  "ring2", "ring3", "eip_addr";
		interrupts = <GIC_SPI 19 IRQ_TYPE_LEVEL_HIGH>,
			     <GIC_SPI 20 IRQ_TYPE_LEVEL_HIGH>,
			     <GIC_SPI 21 IRQ_TYPE_LEVEL_HIGH>,
			     <GIC_SPI 22 IRQ_TYPE_LEVEL_HIGH>,
			     <GIC_SPI 23 IRQ_TYPE_LEVEL_HIGH>,
			     <GIC_SPI 24 IRQ_TYPE_LEVEL_HIGH>;
		dma-coherent;
		dma-bus-width = <32>;
		cell-index = <0>;
		status = "disabled";
	};
```

## Documentation/devicetree/bindings/crypto/mv_eip197.txt
```
Marvell EIP197 Security Packet Engine with Classifiers

Required properties:
- compatible: should be one of the following string
	      "marvell,eip197"
- reg: base physical address of the engine and length of memory mapped region.
- interrupts: interrupt number
- clocks: One ore more clock gating clocks to be used to enable EIP197 unit in the SoC.

Optional properties:
- dma-coherent: Present if dma operations are coherent

Examples:

eip197: eip197@800000 {
	compatible = "marvell,eip197";
	reg = <0x800000 0x200000>;
	dma-coherent;
	interrupts = <GIC_SPI 54 IRQ_TYPE_LEVEL_HIGH>;
	clocks = <&gateclk 26>;
	status = "disabled";
};
```

## Documentation/devicetree/bindings/crypto/mvebu_cesa.txt
```
* Marvell Cryptographic Engines And Security Accelerator

To support CESA in dts two separate nodes are required:
	- one for CESA engine with compatible "marvell,armada-cesa"
	- second one for internal CESA SRAM with compatible "marvell,cesa-sram"

Note that Marvell chips have maximum 2 available CESA channels.

======================================
- CESA engine ("marvell,armada-cesa")
======================================
Required properties:

- compatible : should be "marvell,armada-cesa"

- reg : base physical address of the engine and length of memory mapped
        region, followed by base physical address of tdma and length of memory
	mapped region. For more then one CESA channels see the example bellow.

- clocks : must contain an entry for each clock gate
	- armada-38x: requires two entry for one channel ("crypto0", "crypto0z")
	  for second channels see the example bellow
	- armada-xp: requires one entry for whole engine
	- armada-370: requires one entry for whole engine

- clock-names : require the following entries:
	- armada-38x: "crypto0" and "crypto0z" for channel0;
		      "crypto1" and "crypto1z" for channel1
	- armada-xp: permit one entry or lack of clock-names properties
	- armada-370: permit one entry or lack of clock-names properties

- cesa,channels : number of CESA channels
	- armada-38x: has 2 available cesa channels
	- armada-xp: has 2 available cesa channels
	- armada-370: has 1 available cesa channel

- cesa,mode : CESA can operate in one of the following mode 'ocf' or 'test'

- cesa,feature : depends on chip, CESA can operate in one of the following mode:
	- armada-38x: "chain", "int_coalescing" or "int_per_packet"(no optimization)
	- armada-xp: "chain", "int_coalescing" or "int_per_packet"(no optimization)
	- armada-370: "chain" or "int_per_packet"(no optimization)

- cesa,threshold : valid only with "int_coalescing" feature
	This field provides a way to minimize the number of interrupts to off
	load the CPU. It defines the number of <AccAndTDMAInt_CM> indications
	before asserting the <EopCoalInt> bit in the Cryptographic interrupt
	Cause Register.

- cesa,time_threshold : valid only with "int_coalescing" feature
	This field provides a way to ensure maximum delay between
	<AccAndTDMAInt_CM> assertion and assertion bit <EopCoalInt> in
	Cryptographic Interrupt Cause Register (even if the number of
	<AccAndTDMAInt_CM> indications did not reach the <EopCoalPacketTh> value).

- cesa,ctrlModel : 16-bit device model ID:
	- armada-38x: <0x6800>
	- armada-xp: <0x7846>
	- armada-370: <0x6710>

- cesa,ctrlRev : 8-bit device revision ID

- cesa,sramOffset : 16-bit SRAM offset

- interrupts : interrupt number (defined per channel in child node - see
	example bellow)

Example:

	crypto@9D000 {
		compatible = "marvell,armada-cesa";
		reg = <0x9D000 0x1000	/* cesa base reg chan 0 */
		       0x90000 0x1000	/* tdma base reg chan 0 */
		       0x9F000 0x1000	/* cesa base reg chan 1 */
		       0x92000 0x1000>;	/* tdma base reg chan 1 */
		clocks = <&gateclk 23>, <&gateclk 14>,
		         <&gateclk 21>, <&gateclk 16>;
		clock-names = "crypto0", "crypto0z",
			      "crypto1", "crypto1z";
		cesa,channels = <0x2>;
		cesa,mode = "ocf";	/* ocf or test */
		cesa,feature = "int_coalescing"; /* chain, int_coalescing
					   or int_per_packet */

		/* threshold and time_threshold relevant if
		   int_coalescing in use */
		cesa,threshold = <0x2>;
		cesa,time_threshold = <0xfffff>;

		cesa,ctrlModel = /bits/ 16 <0x6800>;
		cesa,ctrlRev = /bits/ 8 <2>;
		cesa,sramOffset = /bits/ 16 <0>;
		status = "disabled";

		crypto10 {
			/* channel 0 */
			interrupts = <0 19 0x4>;
		};
		crypto11 {
			/* channel 1 */
			interrupts = <0 20 0x4>;
		};

	};


======================================
- CESA SRAM ("marvell,cesa-sram")
======================================

Required properties in soc ranges:

- ranges : entry in soc ranges for static decoding window configuration. For
	more information read Documentation/devicetree/bindings/bus/mvebu-mbus.txt


Required properties in cesa-sram node:

- compatible : should be "marvell,cesa-sram"
- reg : target ID, attribute ID, with use of MBUS_ID macro, followed by base
	physical address and size of the SRAM, for each channel. For more
	information read Documentation/devicetree/bindings/bus/mvebu-mbus.txt


Example:

	soc {
		ranges = <MBUS_ID(0xf0, 0x01) 0 0xf1000000 0x100000
			  MBUS_ID(0x09, 0x01) 0 0xf1100000 0x10000	/* CESA0: PHYS=0xf1100000
									   size 64K */
			  MBUS_ID(0x09, 0x05) 0 0xf1110000 0x10000>;	/* CESA1: PHYS=0xf1110000
									   size 64K */

		/* Security Accelerator SRAM (CESA) */
		cesa-sram {
			compatible = "marvell,cesa-sram";
			reg = <MBUS_ID(0x09, 0x01) 0 0x10000   /*chan0*/
			       MBUS_ID(0x09, 0x05) 0 0x10000>; /*chan1*/
		};
	};
```

## Documentation/devicetree/bindings/dma/mv-xor-v2.txt
```
* Marvell XOR v2 engines

Required properties:
- compatible: Should be "marvell,mv-xor-v2"
- reg: Should contain registers location and length (two sets)
    the first set is the DMA registers
    the second set is the global registers
- dma-bus-width: DMA address bus width
- msi-parent: Phandle to the MSI-capable interrupt controller used for
  interrupts.
- clocks: One or more clock gating clocks to be used to enable DMA engine
  unit in the SoC.

Optional properties:
The below is relevant only if Marvell Userspace SDK (MUSDK) is in use:
- musdk-mode (bool): Indicates whether the device is to be controlled by musdk framework.
  In this case, the probe process of the device is skipped, in order not to create
  a contention with the user-space drivers.
  In some cases, when musdk mode is enabled, the device will be attached to a generic
  uio instance, and this is why its not marked as "status=disabled".
  For more info about attaching the device to generic-uio instance, see
  Documentation/devicetree/bindings/uio/uio_pdrv_genirq.txt

Example:

	xor0@400000 {
		compatible = "marvell,mv-xor-v2";
		reg = <0x400000 0x1000>,
		      <0x410000 0x1000>;
		msi-parent = <&gic_odmi>;
		clocks = <&gateclk 14>;
		dma-coherent;
		dma-width = <40>;
	};


	/* musdk-mode enabled example */
	xor0@400000 {
		compatible = "marvell,mv-xor-v2";
		reg = <0x400000 0x1000>,
		      <0x410000 0x1000>;
		msi-parent = <&gic_odmi>;
		clocks = <&gateclk 14>;
		dma-coherent;
		musdk-mode;
		uio-name = "uio_dma_xor_0";
		dma-width = <40>;
	};
```

## Documentation/devicetree/bindings/gpio/gpio-armada-3700.txt
```
* Marvell armada-3700 GPIO controller

Required properties:

- compatible : Should be "marvell,armada3700-gpio".

- reg: Address and length of the register set for the device. 2
  entries are expected, one for the general registers,
  one for the interrupt registers.

- interrupts: The list of interrupts that are used for all the pins
  managed by this GPIO bank.

- interrupt-controller: Identifies the node as an interrupt controller,
  armada3700 gpio interrupt controller are cascaded to root gic interrupt
  controller.

- #interrupt-cells: Specifies the number of cells needed to encode an
  interrupt source. Should be two.
  The first cell is the GPIO number.
  The second cell is used to specify flags:
    bits[3:0] trigger type and level flags:
      1 = low-to-high edge triggered.
      2 = high-to-low edge triggered.
      4 = active high level-sensitive.
      8 = active low level-sensitive.
    Armada-3700 only supports edge type gpio interrupts.

- gpio-controller: Marks the device node as a GPIO controller

- ngpios: Number of GPIOs this controller has

- #gpio-cells: Should be two. The first cell is the pin number. The
  second cell is reserved for flags, unused at the moment.

Optional:
- gpiobase: The base of the GPIO bank, if not defined the base calculated by
  multiplying the bank ID number by MVEBU_MAX_GPIO_PER_BANK_A3700 (36)
  This option used in Armada-3700 SoC, because the GPIOs count is different between banks
  In Armada-3700: north bridge has 36 GPIOs and south bridge has 30 GPIOs,
  The base of north bridge gpio bank should be 0 and the base of south bridge gpio bank
  should be 36

Example:
		gpio_nb: gpio@13800 {
			compatible = "marvell,armada3700-gpio";
			reg = <0x13800 0x30
				0x13c00 0x20>;
			ngpios = <36>;
			gpiobase = <0>;
			gpio-controller;
			#gpio-cells = <2>;
			interrupt-controller;
			#interrupt-cells = <2>;
			interrupts = <GIC_SPI 51 IRQ_TYPE_LEVEL_HIGH>,
				     <GIC_SPI 52 IRQ_TYPE_LEVEL_HIGH>,
				     <GIC_SPI 53 IRQ_TYPE_LEVEL_HIGH>,
				     <GIC_SPI 54 IRQ_TYPE_LEVEL_HIGH>,
				     <GIC_SPI 55 IRQ_TYPE_LEVEL_HIGH>,
				     <GIC_SPI 56 IRQ_TYPE_LEVEL_HIGH>,
				     <GIC_SPI 57 IRQ_TYPE_LEVEL_HIGH>,
				     <GIC_SPI 58 IRQ_TYPE_LEVEL_HIGH>,
				     <GIC_SPI 152 IRQ_TYPE_LEVEL_HIGH>,
				     <GIC_SPI 153 IRQ_TYPE_LEVEL_HIGH>,
				     <GIC_SPI 154 IRQ_TYPE_LEVEL_HIGH>,
				     <GIC_SPI 155 IRQ_TYPE_LEVEL_HIGH>;
		};
```

## Documentation/devicetree/bindings/gpio/gpio-mvebu.txt
```
* Marvell EBU GPIO controller

Required properties:

- compatible : Should be "marvell,orion-gpio", "marvell,mv78200-gpio"
  or "marvell,armadaxp-gpio". "marvell,orion-gpio" should be used for
  Orion, Kirkwood, Dove, Discovery (except MV78200), Armada 370, and
  Armada 7k&8k AP/CP. "marvell,mv78200-gpio" should be used for the
  Discovery MV78200. "marvel,armadaxp-gpio" should be used for all
  Armada XP SoCs (MV78230, MV78260, MV78460).

- reg: Address and length of the register sets for the device.
  - For "marvell,mv78200-gpio" compatible, one entry for the general registers;
  - For "marvell,armadaxp-gpio" compatible, two entries are expected:
    one for the general registers, one for the per-cpu registers.
  - For "marvell,orion-gpio" compatible, reg can be one entry or two entries:
    for Armada 7k&8k AP GPIO controllers, reg has two entries: one for the general
    registers, one for soc interrupt registers;
    for other controllers, reg has one entry for the general registers.

- interrupts: The list of interrupts that are used for all the pins
  managed by this GPIO bank. There can be more than one interrupt
  (example: 1 interrupt per 8 pins on Armada XP, which means 4
  interrupts per bank of 32 GPIOs).

- interrupt-controller: Identifies the node as an interrupt controller

- #interrupt-cells: Specifies the number of cells needed to encode an
  interrupt source. Should be two.
  The first cell is the GPIO number.
  The second cell is used to specify flags:
    bits[3:0] trigger type and level flags:
      1 = low-to-high edge triggered.
      2 = high-to-low edge triggered.
      4 = active high level-sensitive.
      8 = active low level-sensitive.

- gpio-controller: Marks the device node as a GPIO controller

- ngpios: Number of GPIOs this controller has

- #gpio-cells: Should be two. The first cell is the pin number. The
  second cell is reserved for flags, unused at the moment.

Optional:
- gpiobase: The base of the GPIO bank, if not defined the base calculated by
  multiplying the bank ID number by MVEBU_MAX_GPIO_PER_BANK (32)
  This option used in Armada-8k SoC, because the GPIOs count is different between banks
  In Armada-70x0: AP-806 has 20 GPIOs and CP-110 has 63 GPIOs that split into 2 banks,
  The base of CP0 bank0 should be 20 (after AP-806 pins) the base of CP0 bank1 should be
  52 (after AP-806, and CP0 bank0 pins)

Example:

		gpio0: gpio@d0018100 {
			compatible = "marvell,armadaxp-gpio";
			reg = <0xd0018100 0x40>,
			    <0xd0018800 0x30>;
			ngpios = <32>;
			gpio-controller;
			#gpio-cells = <2>;
			interrupt-controller;
			#interrupt-cells = <2>;
			interrupts = <16>, <17>, <18>, <19>;
		};
```
