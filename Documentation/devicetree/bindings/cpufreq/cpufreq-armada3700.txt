## Documentation/devicetree/bindings/interrupt-controller/marvell,advk-ic.txt
```
Marvell Armada 3700 PCIe auxiliary IRQ controller
--------------------------------------------------

Required properties:

- compatible	       : The value here should contain "marvell,advk-ic".

- interrupt-controller : Identifies the node as an interrupt controller.

- msi-controller       : Identifies the node as an MSI interrupt controller.

- #interrupt-cells     : The number of cells to define the interrupts.
                         Should be 1. The cell is the IRQ number.

- interrupts           : Controller's parent interrupt.

- reg		       : List of register definitions, one for each
                         configuration region.

Example:

	advk_ic: interrupt-controller@74840 {
		compatible = "marvell,advk-ic";
		reg = <0x74840 0x60
		       0x8b000 0x8>;
		interrupt-controller;
		msi-controller;
		#interrupt-cells = <1>;
		interrupts = <GIC_SPI 29 IRQ_TYPE_LEVEL_HIGH>;
		status = "okay";
	};
```

## Documentation/devicetree/bindings/interrupt-controller/marvell,icu.txt
```
Marvell ICU Interrupt Controller
-----------------------------------------------------
The Marvell ICU (Interrupt Consolidation Unit) controller is responsible for
accumulating all wired-interrupt sources in the CP and communicating them to
the GIC in the AP, the unit translates interrupt requests on input wires to MSG
memory mapped transactions to the GIC.

The interrupts from the ICU to the GIC can be mapped to one of the following groups:
	- Shared Peripheral Interrupt - Non-Secured (SPI_NSR)
	- Shared Peripheral Interrupt - Secured (SPI_SR)
	- System Error Interrupt (SEI)
	- RAM Error Interrupt (REI)

Required properties:
- compatible: Should be "marvell,icu"
- reg: Should contain ICU registers location and length.
- #interrupt-cells: Number of cells to define interrupts.
		Should be 3:
			Group type of the ICU interrupt (SPI_NSR, SPI_SR, SEI, and REI)
			Index of the unit in ICU unit
			Type of the interrupt
- #size-cells: The size of the interrupt cell. Should be 1.
- #address-cells: The size of unit addresses, should be 0.
- interrupt-controller: Identifies the node as an interrupt controller.
- interrupt-parent: Indicates the node of the parent interrupt controller.
		Should be pointer for GIC node.
- gicp-spi: GICP SPI assert & deassert interrupt address on remote side (AP) Must contain 4 entries:
		- 2 entries to specify the high and low portions of the GIC
		  register address for asserting an interrupt
		- 2 entries to specify the high and low portions of the GIC
		  register address for deasserting an interrupt
		The full gicp-spi entry should be in the below order:
		<GICP_SPI_SET_HIGH GICP_SPI_SET_LOW GICP_SPI_CLR_HIGH GICP_SPI_CLR_LOW>

Example:

icu: interrupt-controller@1E0000 {
	compatible = "marvell,icu";
	reg = <0x1E0000 0x10>;
	#interrupt-cells = <2>;
	#size-cells = <1>;
	#address-cells = <0>;
	interrupt-controller;
	interrupt-parent = <&gic>;
	gicp-spi = <0x0 0xF03F0040 0x0 0xF03F0048>;
};

Usage in device:
usb3h0: usb3@500000 {
...
interrupt-parent = <&icu>;
interrupts = <ICU_GRP_NSR 106 IRQ_TYPE_LEVEL_HIGH>;
...
};
```

## Documentation/devicetree/bindings/interrupt-controller/marvell,pic.txt
```
Marvell PIC Interrupt Controller
-----------------------------------------------------
The Marvell PIC interrupt controller is a simple per-cpu
interrupt aggregator. It receives per-cpu interrupts from
several sources and aggregates them to a single interrupt
line on the primary interrupt controller.

Required properties:
- compatible: Should be "marvell,pic"
- interrupt-controller: Identifies the node as an interrupt controller.
- interrupt-parent : Indicates the node of the parent interrupt controller.
- #interrupt-cells: Number of cells to define interrupts. Should be 1. The cell is the IRQ number.
- #size-cells: The size of the interrupt cell. Should be 1.
- reg: Should contain PIC registers location and length.
- interrupts: Identifies the IRQ nunmber of the parent IRQ controller to which the PIC is connected to.
- irq-mask: Indicates the valid interrupts supported by this instance of PIC.
- int-en-pol: Interrupt mask polarity - 0 means that writing 0 to the pic int-mask reg enables the interrupt.
		Please refer to the functional spec to figure the right polarity for a specific SoC.

Example:

	pic: interrupt-controller@3f0100 {
		compatible = "marvell,pic";
		reg = <0x3f0100 0x10>;
		irq-mask = <0x7001f>;  /* interrupts 0,1,2,3,4,16,17,18 */
		int-en-pol = <0>; /* 0 unmasks / enables the interrupt. */
		#interrupt-cells = <1>;
		#size-cells = <1>;
		interrupt-controller;
		interrupt-parent = <&gic>;
		interrupts = <GIC_PPI 12 IRQ_TYPE_LEVEL_HIGH>;
	};
```

## Documentation/devicetree/bindings/interrupt-controller/marvell,sei.txt
```
Marvell SEI Interrupt Controller
-----------------------------------------------------
The Marvell SEI (System Error Interrupt) controller is an interrupt aggregator.
It receives interrupts from several sources and aggregates them to a single
interrupt line (of SEI interrupt) on the primary interrupt controller.

Required properties:
- compatible: Should be "marvell,sei"
- reg: Should contain SEI registers location and length.
- #interrupt-cells: Number of cells to define interrupts. Should be 1. The cell is the IRQ number.
- #size-cells: The size of the interrupt cell. Should be 1.
- interrupt-controller: Identifies the node as an interrupt controller.
- interrupt-parent : Indicates the node of the parent interrupt controller.
- interrupts: Identifies the IRQ nunmber of the parent IRQ controller to which the SEI is connected to.

Example:


	sei: interrupt-controller@3f0200 {
		compatible = "marvell,sei";
		reg = <0x3f0200 0x30>;
		#interrupt-cells = <1>;
		#size-cells = <1>;
		interrupt-controller;
		interrupt-parent = <&gic>;
		interrupts = <GIC_SPI 0 IRQ_TYPE_LEVEL_HIGH>;
	};
```

## Documentation/devicetree/bindings/misc/marvell,sample-at-reset.txt
```
* Marvell Sample at Reset Info

Required properties:
- compatible: Should be "marvell,sample-at-reset-ap806" fpr AP806, or
              "marvell,a70x0-sample-at-reset" for CP0 on A7K,
              or "marvell,a80x0-cp0-sample-at-reset" for CP0 on A8K,
              or "marvell,a80x0-cp1-sample-at-reset" for CP1 on A8K.
- reg: Should contain registers location and length.

Example for AP806:
ap806_sar: sar@6f8200 {
	compatible = "marvell,sample-at-reset-ap806";
	reg = <0x6f8200 0x8>;
	status = "okay";
};

Example for CP110 on A7K:
cpm_sar: sar@400200 {
	compatible = "marvell,a70x0-sample-at-reset";
	reg = <0x400200 0x8>;
	status = "okay";
};
```

## Documentation/devicetree/bindings/mmc/marvell,xenon-sdhci.txt
```
Marvell Xenon SDHCI Controller device tree bindings
This file documents differences between the core mmc properties
described by mmc.txt and the properties used by the Xenon implementation.

Multiple SDHCs might be put into a single Xenon IP, to save size and cost.
Each SDHC is independent and owns independent resources, such as register sets,
clock and PHY.
Each SDHC should have an independent device tree node.

Required Properties:
- compatible: should be one of the following
  - "marvell,armada-3700-sdhci": For controllers on Armada-3700 SOC.
  Must provide a second register area and marvell,pad-type.
  - "marvell,armada8k-sdhci": For controllers on Armada 7K/8K SOC.

- clocks:
  Array of clocks required for SDHC.
  Require at least input clock for Xenon IP core.

- clock-names:
  Array of names corresponding to clocks property.
  The input clock for Xenon IP core should be named as "core".

- reg:
  * For "marvell,armada-3700-sdhci", two register areas.
    The first one for Xenon IP register. The second one for the Armada 3700 SOC
    PHY PAD Voltage Control register.
    Please follow the examples with compatible "marvell,armada-3700-sdhci"
    in below.
    Please also check property marvell,pad-type in below.

  * For other compatible strings, one register area for Xenon IP.

Optional Properties:
- mmc-card:
  mmc-card child node must be provided when current SDHC is for eMMC.
  Xenon SDHC often can support both SD and eMMC. This child node indicates that
  current SDHC is for eMMC card. Thus Xenon eMMC specific configuration and
  operations can be enabled prior to eMMC init sequence.
  Please refer to Documentation/devicetree/bindings/mmc/mmc-card.txt.
  This child node should not be set if current Xenon SDHC is for SD/SDIO.

- bus-width:
  When 8-bit data bus width is in use for eMMC, this property should be
  explicitly provided and set as 8.
  It is optional when data bus width is 4-bit or 1-bit.

- mmc-ddr-1_8v:
  Select this property when eMMC HS DDR is supported on SDHC side.

- mmc-hs400-1_8v:
  Select this property when eMMC HS400 is supported on SDHC side.

- no-1-8-v:
  Select this property when 1.8V signaling voltage supply is unavailable.
  When this property is enabled, both mmc-ddr-1_8v and mmc-hs400-1_8v should be
  cleared.

- marvell,xenon-sdhc-id:
  Indicate the corresponding bit index of current SDHC in
  SDHC System Operation Control Register Bit[7:0].
  Set/clear the corresponding bit to enable/disable current SDHC.
  If Xenon IP contains only one SDHC, this property is optional.

- marvell,xenon-phy-type:
  Xenon support mutilple types of PHYs.
  To select eMMC 5.1 PHY, set:
  marvell,xenon-phy-type = "emmc 5.1 phy"
  eMMC 5.1 PHY is the default choice if this property is not provided.
  To select eMMC 5.0 PHY, set:
  marvell,xenon-phy-type = "emmc 5.0 phy"

  All those types of PHYs can support eMMC, SD and SDIO.
  Please note that this property only presents the type of PHY.
  It doesn't stand for the entire SDHC type or property.
  For example, "emmc 5.1 phy" doesn't mean that this Xenon SDHC only supports
  eMMC 5.1.

- marvell,xenon-phy-znr:
  Set PHY ZNR value.
  Only available for eMMC PHY 5.1 and eMMC PHY 5.0.
  Valid range = [0:0x1F].
  ZNR is set as 0xF by default if this property is not provided.

- marvell,xenon-phy-zpr:
  Set PHY ZPR value.
  Only available for eMMC PHY 5.1 and eMMC PHY 5.0.
  Valid range = [0:0x1F].
  ZPR is set as 0xF by default if this property is not provided.

- marvell,xenon-phy-nr-success-tun:
  Set the number of required consecutive successful sampling points used to
  identify a valid sampling window, in tuning process.
  Valid range = [1:7].
  Set as 0x4 by default if this property is not provided.

- marvell,xenon-phy-tun-step-divider:
  Set the divider for calculating TUN_STEP.
  Set as 64 by default if this property is not provided.

- marvell,xenon-phy-slow-mode:
  If this property is selected, transfers will bypass PHY.
  Only available when bus frequency lower than 55MHz in SDR mde.
  Disabled by default. Please only try this property if timing issues always
  occur with PHY enabled in eMMC HS SDR, SD SDR12, SD SDR25, SD SDR50 mode.

- marvell,xenon-tun-count:
  Xenon SDHC SOC usually doesn't provide re-tuning counter in
  Capabilities Register 3 Bit[11:8].
  This property provides the re-tuning counter.
  If this property is not set, default re-tuning counter will
  be set as 0x9 in driver.

- marvell,pad-type:
  Type of Armada 3700 SOC PHY PAD Voltage Controller register.
  Only valid when "marvell,armada-3700-sdhci" is selected.
  Two types: "sd" and "fixed-1-8v".
  If "sd" is slected, SOC PHY PAD is set as 3.3V at the beginning and is
  switched to 1.8V when SD in UHS-I.
  If "fixed-1-8v" is slected, SOC PHY PAD is fixed 1.8V, such as for eMMC.
  Please follow the examples with compatible "marvell,armada-3700-sdhci"
  in below.

Example:
- For eMMC:

	sdhci@aa0000 {
		compatible = "marvell,armada8k-sdhci";
		reg = <0xaa0000 0x1000>;
		interrupts = <GIC_SPI 13 IRQ_TYPE_LEVEL_HIGH>
		clocks = <&emmc_clk>;
		clock-names = "core";
		bus-width = <8>;
		mmc-ddr-1_8v;
		mmc-hs400-1_8v;
		marvell,xenon-sdhc-id = <0>;
		marvell,xenon-phy-type = "emmc 5.1 phy";
		marvell,xenon-tun-count = <11>;

		#address-cells = <1>;
		#size-cells = <0>;
		mmccard: mmccard@0 {
			compatible = "mmc-card";
			reg = <0>;
		};
	};

- For SD/SDIO:

	sdhci@ab0000 {
		compatible = "marvell,armada8k-sdhci";
		reg = <0xab0000 0x1000>;
		interrupts = <GIC_SPI 55 IRQ_TYPE_LEVEL_HIGH>
		vqmmc-supply = <&sd_regulator>;
		clocks = <&sdclk>;
		clock-names = "core";
		bus-width = <4>;
		marvell,xenon-tun-count = <9>;
	};

- For eMMC with compatible "marvell,armada-3700-sdhci":

	sdhci@aa0000 {
		compatible = "marvell,armada-3700-sdhci";
		reg = <0xaa0000 0x1000>,
		      <phy_addr 0x4>;
		interrupts = <GIC_SPI 13 IRQ_TYPE_LEVEL_HIGH>
		clocks = <&emmcclk>;
		clock-names = "core";
		bus-width = <8>;
		mmc-ddr-1_8v;
		mmc-hs400-1_8v;

		marvell,pad-type = "fixed-1-8v";

		#address-cells = <1>;
		#size-cells = <0>;
		mmccard: mmccard@0 {
			compatible = "mmc-card";
			reg = <0>;
		};
	};

- For SD/SDIO with compatible "marvell,armada-3700-sdhci":

	sdhci@ab0000 {
		compatible = "marvell,armada-3700-sdhci";
		reg = <0xab0000 0x1000>,
		      <phy_addr 0x4>;
		interrupts = <GIC_SPI 55 IRQ_TYPE_LEVEL_HIGH>
		vqmmc-supply = <&sd_regulator>;
		clocks = <&sdclk>;
		clock-names = "core";
		bus-width = <4>;

		marvell,pad-type = "sd";
	};
```

## Documentation/devicetree/bindings/mmc/mmc-pwrseq-a3700-sd.txt
```
* Marvell armada3700 SD power sequence provider

Required properties:
- compatible: must be "mmc-pwrseq-a3700-sd".
- pwren-gpios: contains a pwren GPIO specifier with the
		   default active state

Example:

	sd_pwrseq: sd_pwrseq {
		compatible = "mmc-pwrseq-a3700-sd";
		pwren-gpios = <&expander0 4 GPIO_ACTIVE_HIGH>;
	}
```
