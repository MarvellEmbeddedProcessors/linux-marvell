## Documentation/devicetree/bindings/phy/phy-comphy-mvebu.txt
```
Marvell EBU Comphy binding
==========================

This binding describes a Comphy device that is used to control
and configure comphy hardware on Marvell SoCs.

Each Comphy device has several PHYs which can be configured
to support various modes:
SATA, USB, PCIE, Network modes, etc.

Required properties for comphy node:
	- compatible:	Should be "marvell,cp110-comphy"
	- reg:			Address and length of register sets
				    for each device in "reg-names"
	- reg-names:	The names of the register addresses
					corresponding to the registers filled in "reg".
	- #phy-cells:	Standard property (Documentation: phy-bindings.txt)
					Should be 2.
	- dfx-reg:	Address and length of DFX register which is needed when PCIe
			COMPHY initialization on CP110. It is optional, and should not
			be modified if it exist.
	- sar-data:	The phandle to Sample At Reset(SAR), which is needed when PCIe
			COMPHY initialization on CP110. It is optional, and should not
			be modified if it exist.
	Example will be provided in the end of this file.

Each device using Comphy should have handle with the following properties:
	- Handle to the Comphy node.
	- Comphy index (SerDes lane number).
	- Required Comphy description.
	  There are 2 options to describe the COMPHY settings.
	  1. Simplified description (default speed & invert settings)
	     With this approach, comphy settings are selected by a single definition
	     which describes the COMPHY type and the unit index. This description
	     configures default speed and no polarity invert for COMPHY lane.
	     Default speed is for COMPHYs with configurable speed, such as SGMII - 1Gbps/2.5Gbps
	     - Simplified usage options:
				- COMPHY_SATA0 COMPHY_SATA1
				- COMPHY_SGMII0 COMPHY_SGMII1 COMPHY_SGMII2
				- COMPHY_HS_SGMII0 COMPHY_HS_SGMII1 COMPHY_HS_SGMII2
				- COMPHY_USB3H0 COMPHY_USB3H1
				- COMPHY_USB3D0
				- COMPHY_PCIE0 COMPHY_PCIE1 COMPHY_PCIE2 COMPHY_PCIE3
				- COMPHY_RXAUI0 COMPHY_RXAUI1
				- COMPHY_XFI
				- COMPHY_SFI
				- COMPHY_USB3
	  2. Complex description (for specific speed and/or polarity invert settings)
	     With this approach, comphy settings are selected by the macro COMPHY_DEF,
	     which defines comphy mode, unit index, comphy speed, and comphy RX/TX invert settings.
	     - COMPHY_DEF definition:
		COMPHY_DEF(COMPHY_MODE, COMPHY_ID, COMPHY_SPEED, COMPHY_INVERT)
			COMPHY_MODE:
				- COMPHY_SATA_MODE
				- COMPHY_SGMII_MODE
				- COMPHY_USB3H_MODE
				- COMPHY_USB3D_MODE
				- COMPHY_PCIE_MODE
				- COMPHY_RXAUI_MODE
				- COMPHY_XFI_MODE
				- COMPHY_SFI_MODE
				- COMPHY_USB3_MODE
			COMPHY_UNIT_ID: unit index
				- relevant to following interfaces, SATA, USB, RXAUI, SGMII and PCIE.
				- SATA/USB/RXAUI: 0/1
				- SGMII/PCIE: 0/1/2
			COMPHY_SPEED:
				- COMPHY_SPEED_DEFAULT: for COMPHY type uses fixed speed
				- COMPHY_SPEED_1_25: for SMGII works at 1Gbps
				- COMPHY_SPEED_3_125: for SMGII works at 2.5Gbps
				- COMPHY_SPEED_5_15625G for sfi/xfi works at 5Gbps
				- COMPHY_SPEED_10_3125G for sfi/xfi works at 10Gbps
			COMPHY_INVERT: polarity invert
				- COMPHY_POLARITY_NO_INVERT:  there is no polarity inverted
				- COMPHY_POLARITY_TXD_INVERT: there is TX polarity inverted
				- COMPHY_POLARITY_RXD_INVERT: there is RX polarity inverted
				- COMPHY_POLARITY_ALL_INVERT: there are both TX and RX polarity inverted
	Example will be provided in the end of this file.

Example:
Comphy Node:
============
	comphy0: comphy {
		compatible = "marvell,cp110-comphy";
		reg = <0x441000 0x100>, <0x120000 0x6000>;
		reg-names = "comphy", "serdes";
		dfx-reg = <0x400280 4>;
		#phy-cells = <2>;
		sar-data = <&cpm_sar>;
		status = "okay";
	};

	comphy1: comphy {
		compatible = "marvell,cp110-comphy";
		reg = <0x441000 0x100>, <0x120000 0x6000>;
		reg-names = "comphy", "serdes";
		dfx-reg = <0x400280 4>;
		#phy-cells = <2>;
		sar-data = <&cps_sar>;
		status = "okay";
	};

	a3700_comphy: comphy@18300 {
			compatible = "marvell,mvebu-comphy", "marvell,armada-3700-comphy";
			reg = <0x18300 0x300>, /* comphy */
			      <0x1F000 0x1000>, /* serdes */
			      <0x5c000 0x1000>, /* usb3_gbe1 phy reg */
			      <0xe0178 0x8>; /* lane2 indirect access */
			reg-names = "comphy", "serdes", "usb3_gbe1_phy", "indirect";
			#phy-cells = <2>;
			status = "okay";
	};

Comphy consumer:
===============
	(1) The example with simplified option of comphy description:
		sata@540000 {
			phys = <&comphy0 4 COMPHY_SATA0>
			status = "okay";
		};

		Explain for above sata example:
		- phy handler is comphy0
		- the sata interface uses lane 4 of comphy
		- COMPHY description:
			- the comphy works at SATA mode
			- the unit index of the sata interface is 0
			- the speed is default
			- the invert is also default without polarity inverted

		sata@e0000 {
				status = "okay";
				phys = <&a3700_comphy 2 COMPHY_SATA0>;
		};

	(2) Examples with complex option of comphy description:
		(2.1)	emac2: mac2 {
				phys = <&comphy0 0 COMPHY_DEF(COMPHY_SGMII_MODE,
							      COMPHY_UNIT_ID1,
							      COMPHY_SPEED_1_25G,
							      COMPHY_POLARITY_RXD_INVERT)>;
				phy-names = "comphy";
			};

			Explain for above SGMII example:
			- phy handler is comphy0
			- the SGMII interface uses lane 0 of comphy
			- COMPHY description:
				- the comphy works at SGMII mode
				- the unit index of the sata interface is 1
				- the comphy speed is 1.25G (network speed is 1Gbps)
				- the comphy has rx polarity inverted

		(2.2)	emac0_1: mac0 {
				phy-mode = "sfi";
		                phys = <&comphy0 2 COMPHY_DEF(COMPHY_SFI_MODE,
							      COMPHY_UNIT_ID0,
							      COMPHY_SPEED_10_3125G,
							      COMPHY_POLARITY_NO_INVERT)>;
				phy-names = "comphy";
			};

			Explain for above SFI example:
			- phy handler is comphy0
			- the SFI interface uses lane 2 of comphy
			- COMPHY description:
				- the comphy works at SFI mode
				- the unit index of the sata interface is 0
				- the speed is 10.3125G (network speed is 10Gbps)
				- the comphy has no polarity invertion
```

## Documentation/devicetree/bindings/phy/phy-mvebu-comphy.txt
```
mvebu comphy driver
-------------------

A comphy controller can be found on Marvell Armada 7k/8k on the CP110 or on
Marvell Armada 37xx SoC. It provides a number of shared PHYs used by various
interfaces (network, SATA, USB, PCIe...).

Required properties:

- compatible: should be one of:
	"marvell,comphy-cp110"
	"marvell,comphy-a3700"
- reg: should contain the comphy register location and length.
       In case of "comphy-a3700" address space is divided into four ranges:
       - South Bridge PHY Configuration Registers
       - PCIe and GbE 0 PHY Registers
       - USB3 and GbE 1 PHY Registers
       - AHCI vendor specific indirect Registers
- reg-names: must contain names corresponding to the comphy register ranges.
- marvell,system-controller: should contain a phandle to the
			     system controller node (not relevant for
			     "comphy-a3700").
- #address-cells: should be 1.
- #size-cells: should be 0.

A sub-node is required for each comphy lane provided by the comphy.

Required properties (child nodes):

- reg: comphy lane number.
- #phy-cells : from the generic phy bindings, must be 1. Defines the
               input port to use for a given comphy lane.

Example for marvell,comphy-cp110:

	CP110_LABEL(comphy): phy@120000 {
		compatible = "marvell,comphy-cp110";
		reg = <0x120000 0x6000>;
		reg-names = "comphy";
		marvell,system-controller = <&CP110_LABEL(syscon0)>;
		#address-cells = <1>;
		#size-cells = <0>;

		CP110_LABEL(comphy0): phy@0 {
			reg = <0>;
			#phy-cells = <1>;
		};

		CP110_LABEL(comphy1): phy@1 {
			reg = <1>;
			#phy-cells = <1>;
		};
	};

Example for marvell,comphy-a3700:

	a3700_comphy: comphy@18300 {
		compatible = "marvell,comphy-a3700";
		reg = <0x18300 0x300>, <0x1f000 0x1000>,
		      <0x5c000 0x1000>, <0xe0178 0x8>;
		reg-names = "comphy", "serdes",
			    "usb3_gbe1_phy", "indirect_ahci";
		#address-cells = <1>;
		#size-cells = <0>;

		a3700_comphy0: phy@0 {
			reg = <0>;
			#phy-cells = <1>;
		};

		a3700_comphy1: phy@1 {
			reg = <1>;
			#phy-cells = <1>;
		};

		a3700_comphy2: phy@2 {
			reg = <2>;
			#phy-cells = <1>;
		};
	};
```

## Documentation/devicetree/bindings/phy/phy-mvebu.txt
```
* Marvell MVEBU SATA PHY

Power control for the SATA phy found on Marvell MVEBU SoCs.

This document extends the binding described in phy-bindings.txt

Required properties :

 - reg		   : Offset and length of the register set for the SATA device
 - compatible	   : Should be "marvell,mvebu-sata-phy"
 - clocks	   : phandle of clock and specifier that supplies the device
 - clock-names	   : Should be "sata"

Example:
		sata-phy@84000 {
			compatible = "marvell,mvebu-sata-phy";
			reg = <0x84000 0x0334>;
			clocks = <&gate_clk 15>;
			clock-names = "sata";
			#phy-cells = <0>;
		};

Armada 375 USB cluster
----------------------

Armada 375 comes with an USB2 host and device controller and an USB3
controller. The USB cluster control register allows to manage common
features of both USB controllers.

Required properties:

- compatible: "marvell,armada-375-usb-cluster"
- reg: Should contain usb cluster register location and length.
- #phy-cells : from the generic phy bindings, must be 1. Possible
values are 1 (USB2), 2 (USB3).

Example:
		usbcluster: usb-cluster@18400 {
			compatible = "marvell,armada-375-usb-cluster";
			reg = <0x18400 0x4>;
			#phy-cells = <1>
		};

Armada 3700 and CP110 UTMI PHY
----------------------
Armada 3700 and CP110 comes with two UTMI PHYs for USB2.

Required Properties:

- compatible: For Armada-3700 it is "marvell,armada-3700-utmi-phy",
              and for CP110 it is "marvell,cp110-utmi-phy".
- reg: register ranges as listed in the reg-names property
- reg-names: include the following entries:
             "utmi": utmi registers, which is mandatory and must be first one.
             "utmi-cfg-reg": UTMI config Register, which is needed on CP110.
             "usb-cfg-reg": USB config Register, which is needed on CP110, and
             UTMI0 and UTMI1 share the same USB config register.
- utmi-port: The USB port utmi phy connected to
- #phy-cells: Standard property (Documentation: phy-bindings.txt) Should be 0.
- utmi-index: The index to differentiate the PHY if there are 2 same UTMI PHY,
              and currently it is used by CP110 for UTMI mux config.

Example:
Armada-3700 UTMI PHY Node:
============
		utmi_usb32: utmi@5d000 {
			compatible = "marvell,armada-3700-utmi-phy";
			reg = <0x5d000 0x1000>;
			utmi-port = <0>;
			#phy-cells = <0>;
			status = "okay";
		};

		utmi_usb2: utmi@5f000 {
			compatible = "marvell,armada-3700-utmi-phy";
			reg = <0x5f000 0x1000>;
			utmi-port = <3>;
			#phy-cells = <0>;
			status = "okay";
		};

CP110 UTMI PHY Node:
============
		utmi0: utmi@580000 {
			compatible = "marvell,cp110-utmi-phy";
			reg = <0x580000 0x1000>,
			      <0x440420 0x4>,
			      <0x440440 0x4>;
			reg-names = "utmi", "usb-cfg-reg", "utmi-cfg-reg";
			utmi-port = <UTMI_PHY_TO_USB3_HOST0>;
			utmi-index = <0>;
			#phy-cells = <0>;
			status = "okay";
		};

		utmi1: utmi@581000 {
			compatible = "marvell,cp110-utmi-phy";
			reg = <0x581000 0x1000>,
			      <0x440420 0x4>
			      <0x440444 0x4>;
			reg-names = "utmi", "usb-cfg-reg", "utmi-cfg-reg";
			utmi-port = <UTMI_PHY_TO_USB3_HOST1>;
			utmi-index = <1>;
			#phy-cells = <0>;
			status = "okay";
		};

Armada-3700 UTMI PHY consumer:
=============
		usb@5e000 {
			status = "okay";
			phys = <&utmi_usb2>;
			phy-names = "usb";
		};

		udc@54100 {
			status = "okay";
			phys = <&utmi_usb32>;
			phy-names = "usb";
		};

CP110 UTMI PHY consumer:
=============
		usb3h0: usb3@500000 {
			status = "okay";
			phys = <&utmi0>;
			phy-names = "usb";
		};
		usb3h1: usb3@510000 {
			status = "okay";
			phys = <&utmi1>;
			phy-names = "usb";
		};
```

## Documentation/devicetree/bindings/pinctrl/marvell,armada-3700-pinctrl.txt
```
* Marvell Armada 3700 SoC pinctrl driver for mpp

Please refer to marvell,mvebu-pinctrl.txt in this directory for common binding
part and usage.

Required properties:
- compatible: "marvell,armada-3700-nb-pinctrl" or "marvell,armada-3700-sb-pinctrl"
- reg: register specifier of MPP registers

Available mpp pins/groups and functions:
Note: brackets (x) are not part of the mpp name for marvell,function and given
only for more detailed description in this document.

North bridge: "marvell,armada-3700-nb-pinctrl"
name          pins     functions
================================================================================
mpp0          0        jtag, gpio
mpp1          1        sdio, gpio
mpp2          2        mmc, gpio
mpp3          3        pwm0, gpio
mpp4          4        pwm1, gpio
mpp5          5        pwm2, gpio
mpp6          6        pwm3, gpio
mpp7          7        pmic1, gpio
mpp8          8        pmic0, gpio
mpp9          9        i2c2, gpio
mpp10         10       i2c1, gpio
mpp11         11       fcs0, gpio
mpp12         12       fcs1, gpio
mpp13         13       fcs2, gpio
mpp14         14       fcs3, gpio
mpp15         15       spi, gpio
mpp16         16       1wire, gpio
mpp17         17       uart1, gpio
mpp18         18       spi(quad), gpio
mpp19         19       spi(cs), uart2
mpp20         20       led(led0), pulllow
mpp21         21       led(led1), pulllow
mpp22         22       led(led2), pulllow
mpp23         23       led(led3), pulllow

South bridge: "marvell,armada-3700-sb-pinctrl"
name          pins     functions
================================================================================
mpp0          0        usb32, gpio
mpp1          1        usb2, gpio
mpp2          2        sdio, gpio
mpp3          3        mii, gpio
mpp4          4        pcie1, gpio
mpp5          5        ptp, gpio
mpp6          6        ptp(clk), mii(txerr)
mpp7          7        ptp(trig), mii(carriersense)
mpp8          8        collision, mii(txerr)
```

## Documentation/devicetree/bindings/pinctrl/marvell,armada-ap806-pinctrl.txt
```
* Marvell Armada AP-806 SoC pinctrl driver for MPP

Please refer to marvell,mvebu-pinctrl.txt in this directory for the common binding
part and usage.

Required properties:
- compatible: "marvell,ap806-pinctrl"
- reg: register ranges as listed in the reg-names property
- reg-names: include the following entries:
             "pinctrl": pinctrl registers, which is mandatory and must be first one.
             "mmcio": eMMC PHY IO Control 0 Register.

Available MPP pins/groups and functions:
Note: Brackets (x) are not part of the MPP name for the Marvell function and are
      included only to provide a more detailed description this document.

name    pins    functions
================================================================================
mpp0	0	gpio, sdio(clk), spi0(clk)
mpp1	1	gpio, sdio(cmd), spi0(miso)
mpp2	2	gpio, sdio(d0), spi0(mosi)
mpp3	3	gpio, sdio(d1), spi0(cs0n)
mpp4	4	gpio, sdio(d2), i2c0(sda)
mpp5	5	gpio, sdio(d3), i2c0(sdk)
mpp6	6	gpio, sdio(ds)
mpp7	7	gpio, sdio(d4), uart1(rxd)
mpp8	8	gpio, sdio(d5), uart1(txd)
mpp9	9	gpio, sdio(d6), spi0(cs1n)
mpp10	10	gpio, sdio(d7)
mpp11	11	gpio, uart0(txd)
mpp12	12	gpio, sdio(pw_off), sdio(hw_rst)
mpp13	13	gpio
mpp14	14	gpio
mpp15	15	gpio
mpp16	16	gpio
mpp17	17	gpio
mpp18	18	gpio
mpp19	19	gpio, uart0(rxd), sdio(pw_off)
```
