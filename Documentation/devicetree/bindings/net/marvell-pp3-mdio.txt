## Documentation/devicetree/bindings/staging/mt29f-spi-nand.txt
```
* MTD SPI driver for Micron MT29F (and similar) serial nand flash chips

Required properties:
- #address-cells, #size-cells : Must be present if the device has sub-nodes
  representing partitions.
- compatible : Should be "spinand,mt29f"
- reg : Chip-Select number
- spi-max-frequency : Maximum frequency of the SPI bus the chip can operate at

Example:

	spi-flash@0 {
		#address-cells = <1>;
		#size-cells = <1>;
		compatible = "spinand,mt29f";
		reg = <0>; /* Chip select 0 */
		spi-max-frequency = <104000000>;
	};
```

## Documentation/devicetree/bindings/telephony/mvebu-phone.txt
```
* mvebu (Armada 38x/XP/80x0) TDM telephony controller

Required properties:

- compatible:
  "marvell,armada-380-tdm" for Armada 38x platforms
  "marvell,armada-xp-tdm" for Armada AXP platforms
  "marvell,armada-a8k-tdm" for Armada 80x0 platforms

- reg: physical base address of the controller and length of memory mapped
  region (named "tdm_regs").
  With "marvell,armada-380-tdm" two other regions are required:
  first of those is dedicated for Audio PLL Configuration registers
  (named "pll_regs") and the second one ("dco_div") - for register
  where DCO post-divider for PLL output is set.

- interrupts - TDM controller interrupt

- clocks: phandle for internal gate clock

- clock-names: name associated to the clocks: "gateclk"

Optional properties:

- pclk-freq-mhz: internal pclk frequency. If not set, the driver uses
  default value of 8 MHz

- use-pclk-external: chooses SLIC as an external pclk source

- spi-mode: set <0> for direct connection and <1> for daisy-chain mode.
  If not set, by default direct mode is used. This property is valid
  only for TDM2C devices, for TDMMC it will be ignored.

Example:

tdm@b0000 {
	compatible = "marvell,armada-380-tdm";
	reg = <0xb0000 0x5000>, <0x18400 0xc>, <0x18730 0x4>;
	reg-names = "tdm_regs", "pll_regs", "dco_div";
	interrupts = <0 27 0x4>;
	clocks = <&gateclk 25>;
	clock-names = "gateclk";
	pclk-freq-mhz = <8>;
};

In case an external SLIC is used, there is a need of instantiating it as
a slave SPI device under one of SPI busses (please refer to:
Documentation/devicetree/bindings/spi/spi-bus.txt)

Required properties:

- compatible: "mv_slic" for Armada 38x platforms

- reg: SLIC slave spi device interface chip select number

- spi-max-frequency: SLIC slave spi device interface max clock
  frequency

Zarlink/Silabs SLIC devices require also following properties:

- spi-1byte-cs - switch CS every single byte transferred

- spi-cpol - active-low clk

- spi-cpha - accept data on clk trailing edge

Optional property:

- slic-id - logical ID of SPI device from range 0 - 31. If not used,
  the driver will set it to '0'. If more than one SLIC device is
  used, this property is obligatory for proper operation.

spi1: spi@10680 {
	pinctrl-0 = <&spi1_pins>;
	pinctrl-names = "default";
	status = "okay";

	slic@0 {
		#address-cells = <1>;
		#size-cells = <0>;
		compatible = "mv_slic";
		reg = <0>; /* Chip select 0 */
		spi-max-frequency = <3000000>;
		spi-1byte-cs;
		spi-cpol;
		spi-cpha;
		slic-id = <1>;
	};
};
```

## Documentation/devicetree/bindings/thermal/armada-thermal.txt
```
* Marvell Armada 370/375/380/XP/70x0/80x0 thermal management

Required properties:

- compatible:	Should be set to one of the following:
		marvell,armada370-thermal
		marvell,armada375-thermal
		marvell,armada380-thermal
		marvell,armadaxp-thermal
		marvell,armada-ap806-thermal
		marvell,armada-cp110-thermal

- reg:		Device's register space.
		Two or three entries are expected, see the examples below.
		The first one is required for the sensor register;
		the second one is required for the control register
		to be used for sensor initialization (a.k.a. calibration).
		The third entry is dedicated to the DFX interrupt for
		Armada 38x.

- interrupts:	Should contain interrupt for thermal system
or
- interrupts-extended:
		Should contain parent node and interrupt for thermal system
		(relevant for devices with irq-chip).

- threshold:	Temperature threshold in Celsius, the threshold +/- calculated
		hysteresis (formula below) define the upper and lower watermark
		which when crossing, an interrupt will be asserted.

- hysteresis:	Valid values are 0..3, following is upper/lower watermark calculation:
		high/low watermark = threshold +/- 0.4761 * 2^(hysteresis + 2).
		Following are the corresponding degrees corresponding to
		hysteresis value: 0=>1.9, 1=>3.8,  2=>7.6, 3=>15.2

Example for a38x:

	thermal@e4078 {
		compatible = "marvell,armada380-thermal";
		reg = <0xe4078 0x4>,
		      <0xe4074 0x4>,
		      <0xe4100 0x20>;
		interrupts = <GIC_SPI 78 IRQ_TYPE_LEVEL_HIGH>;
		threshold = <100>;
		hysteresis = <2>;
		status = "okay";
	};

or Example for Armada-7040 (with irq-chip):

	thermal@400078 {
		compatible = "marvell,armada-cp110-thermal";
		reg = <0x400078 0x4>,
		      <0x400070 0x8>,
		      <0x400100 0x20>;
		interrupts-extended = <&sei 37>;
		threshold = <100>;
		hysteresis = <2>;
		status = "okay";
	}
```

## Documentation/devicetree/bindings/tty/serial/mvebu-uart.txt
```
* Marvell UART : Non standard UART used in some of Marvell EBU SoCs (e.g., Armada-3700)

Required properties:
- compatible: "marvell,armada-3700-uart"
- reg: offset and length of the register set for the device.
- interrupts: device interrupt

Example:
	serial@12000 {
		compatible = "marvell,armada-3700-uart";
		reg = <0x12000 0x200>;
		interrupts = <43>;
	};
	serial@12200 {
		compatible = "marvell,armada-3700-uart-ext";
		reg = <0x12200 0x30>,
		status = "disabled";
	};
```

## Documentation/devicetree/bindings/uio/uio_pdrv_genirq.txt
```
This file describes the changes done to the uio_pdrv_genirq driver, along with
the new device-tree properties required to control these features.

Added properties:

- uio-name: Holds the name of the created uio device.
In case this property exists, then it will be used as the uio device name
(/sys/class/uio/uioN/name), in case it's not defined, the driver will use
the node's name as the uio device name.

Example:
	dma_xor@6a0000 {
        	compatible = "marvell,mv-xor-v2";
		reg = <0x6a0000 0x1000>,
	              <0x6b0000 0x1000>;
		musdk-mode;
        	uio-name = "uio_dma_xor_4";
	        status = "okay";
	};
```
