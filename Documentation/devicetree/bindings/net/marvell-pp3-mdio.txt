## Documentation/devicetree/bindings/pinctrl/marvell,armada-cp110-pinctrl.txt
```
* Marvell Armada CP-110 SoC pinctrl driver for MPP

Please refer to marvell,mvebu-pinctrl.txt in this directory for the common binding
part and usage.
Note: In Armada70x0 (with single CP) all the MPPs are available, while in
	Armada-80x0 (dual CP) the MPPs are split into 2 parts, MPPs 0-31 from CP1
	and MPPs 32-62 from CP0

Required properties:
- compatible: "marvell,a70x0-pinctrl", "marvell,a80x0-cp0-pinctrl",
	and "marvell,a80x0-cp1-pinctrl" depends on the specific	variant of the
	SoC being use.
- reg: register specifier of MPP registers

Available MPP pins/groups and functions:
Note: Brackets (x) are not part of the MPP name for the Marvell function and are
      included only to provide a more detailed description this document.

name    pins    functions
================================================================================
mpp0    0       gpio, dev(ale1), au(i2smclk), ge0(rxd3), tdm(pclk), ptp(pulse), mss_twsi_sda, uart0(rxd), sata0(present_activen), ge(mdio)
mpp1    1       gpio, dev(ale0), au(i2sdo_spdifo), ge0(rxd2), tdm(drx), ptp(clk), mss_twsi_sck, uart0(txd), sata1(present_activen), ge(mdc)
mpp2    2       gpio, dev(ad15), au(i2sextclk), ge0(rxd1), tdm(dtx), mss_uart_rxd, ptp(pclk_out), twsi1(sck), uart1(rxd), sata0(present_activen), xg(mdc)
mpp3    3       gpio, dev(ad14), au(i2slrclk), ge0(rxd0), tdm(fsync), mss_uart_txd, pcie(rstoutn), twsi1(sda), uart1(txd), sata1(present_activen), xg(mdio)
mpp4    4       gpio, dev(ad13), au(i2sbclk), ge0(rxctl), tdm(rstn), mss_uart_rxd, uart1(cts), pcie0(clkreq), uart3(rxd), ge(mdc)
mpp5    5       gpio, dev(ad12), au(i2sdi), ge0(rxclk), tdm(intn), mss_uart_txd, uart1(rts), pcie1(clkreq), uart3(txd), ge(mdio)
mpp6    6       gpio, dev(ad11), ge0(txd3), spi0(csn2), au(i2sextclk), sata1(present_activen), pcie2(clkreq), uart0(rxd), ptp(pulse)
mpp7    7       gpio, dev(ad10), ge0(txd2), spi0(csn1), spi1(csn1), sata0(present_activen), led(data), uart0(txd), ptp(clk)
mpp8    8       gpio, dev(ad9), ge0(txd1), spi0(csn0), spi1(csn0), uart0(cts), led(stb), uart2(rxd), ptp(pclk_out), synce1(clk)
mpp9    9       gpio, dev(ad8), ge0(txd0), spi0(mosi), spi1(mosi), pcie(rstoutn), synce2(clk)
mpp10   10      gpio, dev(readyn), ge0(txctl), spi0(miso), spi1(miso), uart0(cts), sata1(present_activen)
mpp11   11      gpio, dev(wen1), ge0(txclkout), spi0(clk), spi1(clk), uart0(rts), led(clk), uart2(txd), sata0(present_activen)
mpp12   12      gpio, dev(clk_out), nf(rbn1), spi1(csn1), ge0(rxclk)
mpp13   13      gpio, dev(burstn), nf(rbn0), spi1(miso), ge0(rxctl), mss_spi_miso
mpp14   14      gpio, dev(bootcsn), dev(csn0), spi1(csn0), spi0(csn3), au(i2sextclk), spi0(miso), sata0(present_activen), mss_spi_csn
mpp15   15      gpio, dev(ad7), spi1(mosi), spi0(mosi), mss_spi_mosi, ptp(pulse_cp2cp)
mpp16   16      gpio, dev(ad6), spi1(clk), mss_spi_clk
mpp17   17      gpio, dev(ad5), ge0(txd3)
mpp18   18      gpio, dev(ad4), ge0(txd2), ptp(clk_cp2cp)
mpp19   19      gpio, dev(ad3), ge0(txd1), wakeup(out_cp2cp)
mpp20   20      gpio, dev(ad2), ge0(txd0)
mpp21   21      gpio, dev(ad1), ge0(txctl), sei(in_cp2cp)
mpp22   22      gpio, dev(ad0), ge0(txclkout), wakeup(in_cp2cp)
mpp23   23      gpio, dev(a1), au(i2smclk), link(rd_in_cp2cp)
mpp24   24      gpio, dev(a0), au(i2slrclk)
mpp25   25      gpio, dev(oen), au(i2sdo_spdifo)
mpp26   26      gpio, dev(wen0), au(i2sbclk)
mpp27   27      gpio, dev(csn0), spi1(miso), mss_gpio4, ge0(rxd3), spi0(csn4), ge(mdio), sata0(present_activen), uart0(rts), rei(in_cp2cp)
mpp28   28      gpio, dev(csn1), spi1(csn0), mss_gpio5, ge0(rxd2), spi0(csn5), pcie2(clkreq), ptp(pulse), ge(mdc), sata1(present_activen), uart0(cts), led(data)
mpp29   29      gpio, dev(csn2), spi1(mosi), mss_gpio6, ge0(rxd1), spi0(csn6), pcie1(clkreq), ptp(clk), mss_twsi_sda, sata0(present_activen), uart0(rxd), led(stb)
mpp30   30      gpio, dev(csn3), spi1(clk), mss_gpio7, ge0(rxd0), spi0(csn7), pcie0(clkreq), ptp(pclk_out), mss_twsi_sck, sata1(present_activen), uart0(txd), led(clk)
mpp31   31      gpio, dev(a2), mss_gpio4, pcie(rstoutn), ge(mdc)
mpp32   32      gpio, mii(col), mii(txerr), mss_spi_miso, tdm(drx), au(i2sextclk), au(i2sdi), ge(mdio), sdio(v18_en), pcie1(clkreq), mss_gpio0
mpp33   33      gpio, mii(txclk), sdio(pwr10), mss_spi_csn, tdm(fsync), au(i2smclk), sdio(bus_pwr), xg(mdio), pcie2(clkreq), mss_gpio1
mpp34   34      gpio, mii(rxerr), sdio(pwr11), mss_spi_mosi, tdm(dtx), au(i2slrclk), sdio(wr_protect), ge(mdc), pcie0(clkreq), mss_gpio2
mpp35   35      gpio, sata1(present_activen), twsi1(sda), mss_spi_clk, tdm(pclk), au(i2sdo_spdifo), sdio(card_detect), xg(mdio), ge(mdio), pcie(rstoutn), mss_gpio3
mpp36   36      gpio, synce2(clk), twsi1(sck), ptp(clk), synce1(clk), au(i2sbclk), sata0(present_activen), xg(mdc), ge(mdc), pcie2(clkreq), mss_gpio5
mpp37   37      gpio, uart2(rxd), twsi0(sck), ptp(pclk_out), tdm(intn), mss_twsi_sck, sata1(present_activen), ge(mdc), xg(mdc), pcie1(clkreq), mss_gpio6, link(rd_out_cp2cp)
mpp38   38      gpio, uart2(txd), twsi0(sda), ptp(pulse), tdm(rstn), mss_twsi_sda, sata0(present_activen), ge(mdio), xg(mdio), au(i2sextclk), mss_gpio7, ptp(pulse_cp2cp)
mpp39   39      gpio, sdio(wr_protect), au(i2sbclk), ptp(clk), spi0(csn1), sata1(present_activen), mss_gpio0
mpp40   40      gpio, sdio(pwr11), synce1(clk), mss_twsi_sda, au(i2sdo_spdifo), ptp(pclk_out), spi0(clk), uart1(txd), ge(mdio), sata0(present_activen), mss_gpio1
mpp41   41      gpio, sdio(pwr10), sdio(bus_pwr), mss_twsi_sck, au(i2slrclk), ptp(pulse), spi0(mosi), uart1(rxd), ge(mdc), sata1(present_activen), mss_gpio2, rei(out_cp2cp)
mpp42   42      gpio, sdio(v18_en), sdio(wr_protect), synce2(clk), au(i2smclk), mss_uart_txd, spi0(miso), uart1(cts), xg(mdc), sata0(present_activen), mss_gpio4
mpp43   43      gpio, sdio(card_detect), synce1(clk), au(i2sextclk), mss_uart_rxd, spi0(csn0), uart1(rts), xg(mdio), sata1(present_activen), mss_gpio5, wakeup(out_cp2cp)
mpp44   44      gpio, ge1(txd2), uart0(rts), ptp(clk_cp2cp)
mpp45   45      gpio, ge1(txd3), uart0(txd), pcie(rstoutn)
mpp46   46      gpio, ge1(txd1), uart1(rts)
mpp47   47      gpio, ge1(txd0), spi1(clk), uart1(txd), ge(mdc)
mpp48   48      gpio, ge1(txctl_mii_txen), spi1(mosi), xg(mdc), wakeup(in_cp2cp)
mpp49   49      gpio, ge1(txclkout), mii(crs), spi1(miso), uart1(rxd), ge(mdio), pcie0(clkreq), sdio(v18_en), sei(out_cp2cp)
mpp50   50      gpio, ge1(rxclk), mss_twsi_sda, spi1(csn0), uart2(txd), uart0(rxd), xg(mdio), sdio(pwr11)
mpp51   51      gpio, ge1(rxd0), mss_twsi_sck, spi1(csn1), uart2(rxd), uart0(cts), sdio(pwr10)
mpp52   52      gpio, ge1(rxd1), synce1(clk), synce2(clk), spi1(csn2), uart1(cts), led(clk), pcie(rstoutn), pcie0(clkreq)
mpp53   53      gpio, ge1(rxd2), ptp(clk), spi1(csn3), uart1(rxd), led(stb), sdio(led)
mpp54   54      gpio, ge1(rxd3), synce2(clk), ptp(pclk_out), synce1(clk), led(data), sdio(hw_rst), sdio(wr_protect)
mpp55   55      gpio, ge1(rxctl_mii_rxdv), ptp(pulse), sdio(led), sdio(card_detect)
mpp56   56      gpio, tdm(drx), au(i2sdo_spdifo), spi0(clk), uart1(rxd), sata1(present_activen)
mpp57   57      gpio, mss_twsi_sda, ptp(pclk_out), tdm(intn), au(i2sbclk), spi0(mosi), uart1(txd), sata0(present_activen)
mpp58   58      gpio, mss_twsi_sck, ptp(clk), tdm(rstn), au(i2sdi), spi0(miso), uart1(cts), led(clk)
mpp59   59      gpio, mss_gpio7, synce2(clk), tdm(fsync), au(i2slrclk), spi0(csn0), uart0(cts), led(stb), uart1(txd)
mpp60   60      gpio, mss_gpio6, ptp(pulse), tdm(dtx), au(i2smclk), spi0(csn1), uart0(rts), led(data), uart1(rxd)
mpp61   61      gpio, mss_gpio5, ptp(clk), tdm(pclk), au(i2sextclk), spi0(csn2), uart0(txd), uart2(txd), sata1(present_activen), ge(mdio)
mpp62   62      gpio, mss_gpio4, synce1(clk), ptp(pclk_out), sata1(present_activen), spi0(csn3), uart0(rxd), uart2(rxd), sata0(present_activen), ge(mdc)
```

## Documentation/devicetree/bindings/pinctrl/marvell,msys-pinctrl.txt
```
* Marvell Msys SoC pinctrl driver for mpp

Please refer to marvell,mvebu-pinctrl.txt in this directory for common binding
part and usage.

Required properties:
- compatible: "marvell,ac3-pinctrl", "marvell,bc2-pinctrl",
              "marvell,bobk-pinctrl"
- reg: register specifier of MPP registers

This driver supports all Msys variants, i.e. AlleyCat3, BobCat2, and BobK.

Available mpp pins/groups and functions:
Note: brackets (x) are not part of the mpp name for marvell,function and given
only for more detailed description in this document.

* Marvell Msys (all variants)

name          pins     functions
================================================================================
mpp0          0        gpo, spi(mosi), dev(ad8)
mpp1          1        gpio, spi(miso), dev(ad9)
mpp2          2        gpo, spi(sck), dev(ad10)
mpp3          3        gpio, spi(cs0), dev(ad11)
mpp4          4        gpio, spi(cs1), mstsmi(mdc), dev(cs0), nf
mpp5          5        gpio, pex(rstout), sdio(cmd), dev(bootcsn)
mpp6          6        gpo, sdio(clk), dev(ad2)
mpp7          7        gpio, sdio(d0), dev(ale0)
mpp8          8        gpio, sdio(d1), dev(ale1)
mpp9          9        gpio, sdio(d2), dev(readyn)
mpp10         10       gpio, sdio(d3), dev(ad12)
mpp11         11       gpio, uart1(rxd), uart0(cts), dev(ad13)
mpp12         12       gpo, uart1(txd), uart0(rts), dev(ad14)
mpp13         13       gpio, pp(intout), i2c1(sck), dev(ad15)
mpp14         14       gpio, i2c0(sck)
mpp15         15       gpio, i2c0(sda)
mpp16         16       gpio, dev(oen), nf(ren)
mpp17         17       gpio, dev(clkout)
mpp18         18       gpio, i2c1(sda), uart1,(txd)
mpp19         19       gpio, uart1(rxd), nf(rbn)
mpp20         20       gpio, dev(wen0), nf(wen)
mpp21         21       gpio, dev(ad0), nf(io0)
mpp22         22       gpio, dev(ad1), nf(io1)
mpp23         23       gpio, dev(ad2), nf(io2)
mpp24         24       gpio, dev(ad3), nf(io3)
mpp25         25       gpio, dev(ad4), nf(io4)
mpp26         26       gpio, dev(ad5), nf(io5)
mpp27         27       gpio, dev(ad6), nf(io6)
mpp28         28       gpio, dev(ad7), nf(io7)
mpp29         29       gpio, dev(a0), nf(cle)
mpp30         30       gpio, dev(a1), nf(ale)
mpp31         31       gpio, slvsmi(mdc), mstsmi(mdc), dev(wen1)
mpp32         32       gpio, slvsmi(mdio), mstsmi(mdio), dev(cs1)
```

## Documentation/devicetree/bindings/pinctrl/marvell,ptp-event.txt
```
* Marvell Armada 39x SoC ptp-event pinctrl driver

Capability to alternate PTP-pin functions gpio/ptp in run-time.

For general understanding pin-control please refer pinctrl.txt.

For gpio refer gpio/gpio.txt.
Pay attention, gpio request toggles the pin-function to gpio.

The same pin-number is used for gpio and for pin-control.
Refer
 pin-control is {mpp10}  here
 gpio number is <10>  in net/marvell-pp3-platform.txt:"ptp-event-pin"

Required properties:
- compatible: "marvell,ptp-event",
- "marvell,mv88f6920-pinctrl"
  Based on the pinctrl-armada-38x.c::armada_38x_mpp_modes[] variants
     V_88F6810_PLUS and V_88F6920_PLUS
- internal-regs: register specifier of MPP registers

Available mpp pins/groups and functions:

name          pins     function-names        Values (for reference)
====================================================================
mpp10         10       "gpio", "ptp"         gpio=0, ptp=0x7(0111b)

Other pins related to PTP used with default values without pinctrl:
mpp8          8        "gpio", "ptp"         gpio=0, ptp=0x7(0111b)
mpp9          9        "gpio", "ptp"         gpio=0, ptp=0x7(0111b)
mpp11         11       "gpio", "ptp"         gpio=0, ptp=0x7(0111b)


DTS/DTSI configuration EXAMPLE (2 parts)
========================================
1). Configuration-SETs for ptp-event pin control:
internal-regs {
	pinctrl {
		compatible = "marvell,mv88f6920-pinctrl";
		........................................
		ptp_event_pin_gpio: ptp_event_pin_gpio {
			marvell,pins = "mpp10";
			marvell,function = "gpio";
		};
		ptp_event_pin_ptp: ptp_event_pin_ptp {
			marvell,pins = "mpp10";
			marvell,function = "ptp";
		};
	};


2). Device for SET alternation:
	ptp_event: ptp-event {
		compatible = "marvell,ptp-event";
		status = "okay";
		pinctrl-0 = <&ptp_event_pin_gpio>;
		pinctrl-1 = <&ptp_event_pin_ptp>;
		pinctrl-names = "gpio", "ptp";
	};


EXAMPLE of init and usage in C-sorce
====================================
  Init:
	pinctrl = devm_pinctrl_get(&pdev->dev);
	pin_gpio_state = pinctrl_lookup_state(pinctrl, "gpio");
	pin_ptp_state  = pinctrl_lookup_state(pinctrl, "ptp");
  Usage - select the state according to required logic:
	pinctrl_select_state(pinctrl, pin_gpio_state);
          or
	pinctrl_select_state(pinctrl, pin_ptp_state);
```

## Documentation/devicetree/bindings/regulator/armada3700-regulator.txt
```
Marvell Armada 3700 voltage regulator by AVS

Required properties:
- compatible: must be "marvell,armada-3700-avs"
- reg: avs register address, which is used to control CPU voltage
- clocks: CPU core clock to get the MAX CPU frequency
- any required generic properties defined in regulator.txt

Example:

	reg_avs: avs@11500 {
		compatible = "marvell,armada-3700-avs";
		reg = <0x11500 0x40>;
		clocks = <&core_clk 4>;
	};
```

## Documentation/devicetree/bindings/reset/marvell,armada-cpu-reset.txt
```
Marvell Armada CPU reset controller
===================================

Please also refer to reset.txt in this directory for common reset
controller binding usage.

Required properties:
- compatible: Should be "marvell,armada-<chip>-cpu-reset"
- reg: should be register base and length as documented in the
  datasheet for the CPU reset register
- #reset-cells: 1, which allows to pass the CPU hardware ID when
  referencing this cpu reset block. See the example below.

cpurst: cpurst@20800 {
	compatible = "marvell,armada-xp-cpu-reset";
	reg = <0x20800 0x20>;
	reset-cells = <1>;
};

And to associate a CPU to its reset controller:

cpu@0 {
	device_type = "cpu";
	compatible = "marvell,sheeva-v7";
	reg = <0>;
	clocks = <&cpuclk 0>;
	resets = <&cpurst 0>;
};
```

## Documentation/devicetree/bindings/sound/armada-370db-audio.txt
```
Device Tree bindings for the Armada 370/385 DB audio
====================================================

These Device Tree bindings are used to describe the audio complex
found on the Armada 370 DB and Armada 385 DB platforms.

Mandatory properties:

 * compatible: must be "marvell,a370db-audio" or "marvell,a385db-audio"

 * marvell,audio-controller: a phandle that points to the audio
   controller of the Armada 370/385 SoC.

 * marvell,audio-codec: a set of three phandles that points to:

    1/ the analog audio codec connected to the Armada 370/A385 SoC
    2/ the S/PDIF transceiver
    3/ the S/PDIF receiver

Example:

	sound {
	      compatible = "marvell,a370db-audio";
	      marvell,audio-controller = <&audio_controller>;
	      marvell,audio-codec = <&audio_codec &spdif_out &spdif_in>;
	      status = "okay";
	};
```

## Documentation/devicetree/bindings/spi/spi-armada-3700.txt
```
Marvell Armada3700 SPI device

Required properties:
- compatible : should be "marvell,armada3700-spi"
- reg        : offset and length of the spi register
- cell-index : index of SPI controllers
- clocks     : gating clock
Optional properties:
- interrupts : interrupt id of SPI controller
               If interrupts cell is missing, the driver
			   is supposed to work in polling mode.
- fifo-mode  : indicate if SPI controller is working in
			   legacy mode or non-legacy mode

Example:
       spi0: spi@10600 {
	       compatible = "marvell,armada3700-spi";
	       #address-cells = <1>;
	       #size-cells = <0>;
	       cell-index = <0>;
	       reg = <0x10600 0xA00>;
	       clocks = <&ngateclk 12>;
	       interrupts = <0 0 4>;
		   fifo-mode;
	       status = "disabled";
       };
```
