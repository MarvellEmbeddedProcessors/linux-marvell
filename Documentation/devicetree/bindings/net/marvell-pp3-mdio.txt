## Documentation/devicetree/bindings/net/marvell-pp3-mdio.txt
```
* Marvell MDIO Ethernet Controller interface

The Ethernet controllers of the Marvel A390 have an identical unit that provides
an interface with the MDIO bus. This driver handles this MDIO
interface.

Required properties:
- compatible: "marvell,pp3-mdio"
- smi_reg: address offset of the SMI GOP register

Optional properties:
- interrupts: interrupt line number for the SMI error/done interrupt
- clocks: Phandle to the clock control device and gate bit

The child nodes of the MDIO driver are the individual PHY devices
connected to this MDIO bus. They must have a "reg" property given the
PHY address on the MDIO bus.

Example at the SoC level:

mdio {
	#address-cells = <1>;
	#size-cells = <0>;
	compatible = "marvell,pp3-mdio";
	smi_reg = <0x5000000>;
};

And at the board level:

mdio {
	phy0: ethernet-phy@0 {
		reg = <0>;
	};

	phy1: ethernet-phy@1 {
		reg = <5>;
	};
}
```

## Documentation/devicetree/bindings/net/marvell-pp3-platform.txt
```
* Marvell Armada 390 Ethernet Controller (PP3)

Required properties:

- compatible: should be "marvell,armada-390-pp3"
- reg: describing the MBus windows have the following layout:

        MBUS_ID(w, a) o z
  where:
   - w is the 'target ID' value for the MBus window
   - a the 'attribute' value for the MBus window
   - o the address offset inside the window
   - s the size of window

  Must contain the following register sets:
	- AMB controller registers
	- A2M Masters 0 and 1 area
	- NSS configuration registers
	- NSS area
- clocks-frequency: define clock frequency NSS unit run with
- interrupts: base of ODMI interrupts used for RX
- gop_access: define access to GOP registers parameters
- ptp-event-pin: GPIO pin number used as ptp-event input

The network interfaces are represented by subnodes.

Required properties:

- id: interafce ID
- emac-data: pointer to relevant emac node (see below)

Example:

pp3_platform {
	compatible = "marvell,armada-390-pp3";
	status = "disabled";
	reg = <MBUS_ID(0xf0, 0x01) 0x70000 0x1000>,    /* A2M Master 0 */
	      <MBUS_ID(0xf0, 0x01) 0x30000 0x1000>,    /* A2M Master 1 */
	      <MBUS_ID(0xf0, 0x01) 0x18a00 0x1000>,    /* AMB registers */
	      <MBUS_ID(0x0c, 0x04) 0       0x800000>,  /* NSS IP registers */
	      <MBUS_ID(0x0c, 0x05) 0       0x8000000>; /* NSS IP space */
	clocks-frequency = <250000000>;
	interrupts = <GIC_SPI 96 IRQ_TYPE_LEVEL_HIGH>;  /* ODMI IRQs */
	gop_access = <&mg_base>;
	ptp-event-pin = <10>;

	nic@0 {
		status = "disabled";
		id = <0>;
		emac-data = <&emac0>;
	};

	nic@1 {
		status = "disabled";
		id = <1>;
		emac-data = <&emac1>;
	};

	nic@2 {
		status = "disabled";
		id = <2>;
		emac-data = <&emac2>;
	};

	nic@3 {
		status = "disabled";
		id = <3>;
		emac-data = <&emac3>;
	};

	nss@0 {
		status = "disabled";
		id = <0>;
	};
};

GOP node describe Group of Ports block and access data, include MAC data.

Required properties:
- mg_base - define remap window information
            The mvebu-mbus DT binding currently doesn't allow
            describing static windows with the remap capability, so we
            need this information to use the mvebu-mbus API to dynamically create the
            required window. This should be changed once mvebu-mbus is
            extended to cover such a case.
- emac0,1,2,3 - MAC data:
  - interrupts: mac link change interrupt line
  - mac-address: plase folder for mac address updated by u-boot
  - phy-mode: one from the following modes: "sgmii", "sgmii2_5", "rgmii", "rxaui", "xaui" or "qsgmii"
  - phy-id: phy address
  - force-link: must be set to "yes" explicitly, if no AN run.

gop {
	status = "disabled";
	mg_base: mg_base {
		gop-base = <0xf8000000>;
		gop-size = <0x400000>;
		mg-target-id = <0xb>;
		mg-attr = <4>;
		mg-remap-base = <0>;
	};

	emac0: mac0 {
		interrupts = <GIC_SPI 49 IRQ_TYPE_LEVEL_HIGH>;  /* Link IRQ */
		mac-address = [ 00 00 00 00 00 00 ];
	};

	emac1: mac1 {
		interrupts = <GIC_SPI 50 IRQ_TYPE_LEVEL_HIGH>;  /* Link IRQ */
		mac-address = [ 00 00 00 00 00 00 ];
	};

	emac2: mac2 {
		interrupts = <GIC_SPI 51 IRQ_TYPE_LEVEL_HIGH>;  /* Link IRQ */
		mac-address = [ 00 00 00 00 00 00 ];
	};
	emac3: mac3 {
		interrupts = <GIC_SPI 53 IRQ_TYPE_LEVEL_HIGH>;  /* Link IRQ */
		mac-address = [ 00 00 00 00 00 00 ];
		phy-mode = "sgmii";
		phy-id = <0>;
		switch-data = <&switch>; /* Optional */
	};
};

For supported boards information see:
Documentation/devicetree/bindings/net/marvell-pp3-a395-db_gp.txt
Documentation/devicetree/bindings/net/marvell-pp3-a390-db.txt
```

## Documentation/devicetree/bindings/net/marvell-xmdio.txt
```
* Marvell xMDIO Ethernet Controller interface

The Ethernet controllers of the Marvel Armada-39x, Armada-7k
and Armada-8k have an identical unit that provides
an interface with the xMDIO bus. This driver handles this xMDIO
interface.

Required properties:
- compatible: "marvell,xmdio"
- reg: address and length of the xSMI register

The child nodes of the xMDIO driver are the individual PHY devices
connected to this xMDIO bus. They must have a "reg" property given the
PHY address on the xMDIO bus.

Example at the SoC level:

mdio {
	#address-cells = <1>;
	#size-cells = <0>;
	compatible = "marvell,xmdio";
	reg = <0x12A600 0x20>;
};

And at the board level:

mdio {
	phy0: ethernet-phy@0 {
		reg = <0>;
	};

	phy1: ethernet-phy@1 {
		reg = <1>;
	};
}
```

## Documentation/devicetree/bindings/net/mv_qd_switch.txt
```
Marvell Distributed Switch Architecture Device Tree Bindings
------------------------------------------------------------

Required properties:
- compatible		: Should be "marvell,mv_qd_switch"
- #address-cells	: Must be 2, first cell is the address on the MDIO bus
			  and second cell is the address in the switch tree.
			  Second cell is used only when cascading/chaining.
- #size-cells		: Must be 0
- mii-bus		: Should be a phandle to a valid MDIO bus device node
- phy_addr		: Should be a phandle to a valid PHY device node accessed by MDIO
- cpu_port		: Should be Switch port number connected to CPU
- connected_port_mask	: Include all switch connected ports
- forced_link_port_mask	: Include switch ports with force link up configuration

Optionnal properties:
- interrupts		: property with a value describing the switch
			  interrupt number (not supported by the driver)


	mv_qd_switch {
		compatible = "marvell,mv_qd_switch";
		#address-cells = <2>;
		#size-cells = <0>;

		interrupts = <10>;
		mii-bus = <&mdio>;
		phy_addr = <&phy0>;	/* MDIO address of switch 0 in tree */
		smi_scan_mode = <0>;	/* scan smi mode */
		cpu_port = <6>;
		forced_link_port_mask = <0x60>;
		connected_port_mask = <0x7f>;
	};
};
```

## Documentation/devicetree/bindings/pci/advk-pci.txt
```
* Aardvark PCIe interface for Marvell Armada-3700

Mandatory properties:

- compatible:
    marvell,armada-3700-pcie
- Status:
	Disabled in dtsi and enable only if needed in dts
- device_type, set to "pci"
- #address-cells, set to <3>
- #size-cells, set to <2>
- #interrupt-cells, set to <3>
- bus-range: PCI bus numbers covered
- msi-parent: parent MSI interrupt controller
- ranges: ranges describing the IO registers to control the PCIe
  interfaces, and ranges describing the Memory windows needed to access
  the memory and I/O regions of each PCIe interface.

For: pcie@1,0
- device_type, set to pci
- assigned-addresses, assigns the PCIe registers offset
- reg set to <0x0800 0 0 0 0>
- #address-cells, set to <3>
- #size-cells, set to <2>
- #interrupt-cells set to <1>
- interrupt-map-mask set to <0 0 0 7>
- interrupt-map this is used for INTX:
	<0 0 0 1 &advk_ic 1>,
	<0 0 0 2 &advk_ic 2>,
	<0 0 0 3 &advk_ic 3>,
	<0 0 0 4 &advk_ic 4>
- marvell,pcie-port set to <0>
- marvell,pcie-lane set to <0>

For the PCIe Interrupt Controller:
- #address-cells set to <0>
- #interrupt-cells set to <1>

Example:

	pcie-controller {
		compatible = "marvell,armada-3700-pcie";
		status = "disabled";
		device_type = "pci";

		#address-cells = <3>;
		#size-cells = <2>;
		dma-coherent;

		msi-parent = <&advk_ic>;

		bus-range = <0x00 0xff>;

		ranges = <0x82000000 0 0x00080000   0 0xD0070000 0 0x20000
			  0x82000000 0 0xe8000000   0 0xe8000000 0 0x1000000 /* Port 0 MEM */
			  0x81000000 0 0xe9000000   0 0xe9000000 0 0x10000 /* Port 0 IO*/>;

		pcie@1,0 {
			device_type = "pci";
			assigned-addresses = <0x82000800 0 0x00080000 0 0x20000>;
			reg = <0x0800 0 0 0 0>;
			#address-cells = <3>;
			#size-cells = <2>;
			#interrupt-cells = <1>;
			ranges = <0x82000000 0 0 0x82000000 0 0xe8000000 1 0
				  0x81000000 0 0 0x81000000 0 0xe9000000 1 0>;
			interrupt-map-mask = <0 0 0 7>;
			interrupt-map =	<0 0 0 1 &advk_ic 1>,
					<0 0 0 2 &advk_ic 2>,
					<0 0 0 3 &advk_ic 3>,
					<0 0 0 4 &advk_ic 4>;
			marvell,pcie-port = <0>;
			marvell,pcie-lane = <0>;
		};
	};
```

## Documentation/devicetree/bindings/pci/armada8k-pcie-ep.txt
```
Armada-8K PCIe End-point DT details:
====================================

Armada-8k uses synopsis designware PCIe controller.

Required properties:
- compatible : should be "marvell,armada8k-pcie-ep", "snps,dw-pcie".
- reg: base addresses and lengths of the pcie core, link management and shadow registers.
- All other definitions as per generic PCI bindings
See "Documentation/devicetree/bindings/pci/designware-pcie.txt"

Example of PCIE EP X1:
pcie-ep@0x600000 {
	compatible = "marvell,armada8k-pcie-ep", "snps,dw-pcie";
	reg = <0 0xf2600000 0 0x4000>, <0 0xf2608000 0 0x80000>, <0 0xf2604000 0 0x1000>;
	reg-names = "core", "lm", "shadow_core";
	clocks = <&cpm_syscon0 1 13>;
	status = "disabled";
};
```

## Documentation/devicetree/bindings/pci/armada8k-pcie.txt
```
Armada-8K PCIe DT details:
==========================

Armada-8k uses synopsis designware PCIe controller.

Required properties:
- compatible : should be "marvell,armada8k-pcie", "snps,dw-pcie".
- reg: base addresses and lengths of the pcie control and global control registers.
 "ctrl" registers points to the global control registers, while the "config" space
 points to the pcie configuration registers as mentioned in dw-pcie dt bindings in the link below.
- interrupt-map-mask and interrupt-map, standard PCI properties to
  define the mapping of the PCIe interface to interrupt numbers.
- All other definitions as per generic PCI bindings
See "documentation/devicetree/bindings/pci/designware-pcie.txt"

Optional properties:
PHY support is still not supported for armada-8k, once it will, the following parameters can be used:
- phys		    : phandle to phy node associated with pcie controller.
- phy-names	    : must be "pcie-phy"

Example:

pcie@0x06000000 {
	compatible = "marvell,armada8k-pcie", "snps,dw-pcie";
	reg = <0 0x608000 0 0x1000>, <0 0x00600000 0 0x01000>;
	reg-names = "ctrl", "config";
	#address-cells = <3>;
	#size-cells = <2>;
	device_type = "pci";

	ranges = <0x00000000 0 0x80000    0  0x00600000 0 0x2000	/* configuration space */
		0x81000000 0 0xf8000000 0  0xf8000000 0 0x10000		/* downstream I/O */
		0x82000000 0 0xf5000000 0  0xf5000000 0 0x1000000>;	/* non-prefetchable memory */

	num-lanes = <1>;
	clocks = <&clks 14>, <&clks 26>;
	clock-names = "pcie", "pcie_bus";
	status = "okay";
};
```

## Documentation/devicetree/bindings/pci/pci-ep-uio.txt
```
* PCI end point UIO driver

This driver implements a generic UIO device that
configures a PCIe end-point and exposes it's resources
to user space

Mandatory properties:

- compatible:  marvell,pci-ep-uio
- reg: a list of named memory spaces to configure to the BARs and host.
       if the base address of a BAR equals 0, a RAM back-end will be
       allocated for the BAR.
- reg-names: accepts "bar0","bar1",.."bar5" and "host-map"
- device-id: The device id to configure in the PCI header
- class_code: The class code to configure in the PCI header
- subclass_code: The sub class code to configure in the PCI header

Example:
The example below creates a NIC endpoint (class 0x2 sub-class 0x0) with
a 1MB BAR-0 backed by RAM and maps 4GB of the host memory space
at address 0x80_0000_0000

pci-ep-uio {
	compatible = "marvell,pci-ep-uio";
	reg = <0 0 0 0x100000>, <0x80 0x00000000 0x1 0x000000000>;
	reg-names = "bar0", "host-map";
	device-id = <0x7080>;
	class-code = <0x2>;
	subclass-code = <0x0>;
	status = "okay";
};
```
