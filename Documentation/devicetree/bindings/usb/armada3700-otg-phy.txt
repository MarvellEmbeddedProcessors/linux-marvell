## drivers/net/ethernet/mvebu_net/pp3/Kconfig
```kconfig
menu "BM configuration"

config MV_ETH_BM_LONG_BUF_NUM
	int "number of buffers for BM long pool"
	default 1024
	---help---
	Default number of buffers allocated for long pools.
	Each buffer is long enough to receive MTU size packet with predefined headroom and tailroom.
	This value is relevant for all ports.
	Number of buffers in each pool can be changed using sysfs command.

config MV_ETH_BM_SHORT_BUF_NUM
	int "number of buffers for BM short pool"
	default 2048
	---help---
	Default number of buffers allocated for short pools.
	This value is relevant for all ports.
	Number of buffers in each pool can be changed using sysfs command.

endmenu

menu "Rx/Tx Queue configuration"

config  MV_ETH_RXQ
        int "Number of RX queues per port"
        default 8
        ---help---
	Number of RX queues to be reserved for each port.
	By default all ingress packets are coming to default RXQ only (MV_ETH_RXQ_DEF).
	Packets can be steered to different RXQs using sysfs commands.

config  MV_ETH_TXQ
        int "Number of TX queues"
        default 1
        ---help---
	Number of TX queues to be reserved for each port.
	By default all egress packets generated by Linux network stack will be sent
	using default TXQ (MV_ETH_TXQ_DEF).
	Packets can be steered to different TXQs using sysfs commands.

config MV_ETH_RXQ_DESC
	int "Number of Rx descriptors"
	default 128
        ---help---
	Default number of RX descriptors in each Rx queue.
	This value is relevant for all RXQs.
	This value can be changed for each RXQ using sysfs command.

config MV_ETH_RXQ_DEF
        int "Default RXQ to recieve packets"
        default 0
        ---help---

config MV_ETH_TXQ_DESC
	int "Number of Tx descriptors"
	default 532
        ---help---
	Default number of TX descriptors in each TX queue.
	This value is relevant for all TXQs.
	This value can be changed for each TXQ using sysfs command.

config MV_ETH_TXQ_DEF
        int "Default TXQ to send local generated packets"
        default 0
        ---help---

endmenu

menu "IP/TCP/UDP Offloading"

endmenu

menu "Control and Statistics"

config  MV_ETH_DEBUG_CODE
	bool "Add run-time debug code"
	default n
	---help---
	When defined special debug code is compiled in kernel image.
	Some debug messages can be enabled/disabled using special sysfs command.
	Used for Debug mode and can cause performance decrease.
	Minory increase kernal image size.

config  MV_ETH_STAT_ERR
        bool "Collect error statistics"
        default y
	---help---
	Marvell network interface driver collect minimal number of statistics.
	Provide information only about error events. Doesn't effect performance.
	Can be displayed using sysfs commands.

config  MV_ETH_STAT_INF
        bool "Collect event statistics"
        default y
        ---help---
	Marvell network interface driver collect event statistics.
	Provide more information about driver functionality and almost doesn't
	effect performance. Can be displayed using sysfs command.

config  MV_ETH_STAT_DBG
        bool "Collect debug statistics"
        default n
        ---help---
	Marvell network interface driver collect a lot of statistics.
	Provide information about each event occurs in the driver.
	Used for Debug mode and can cause performance decrease.
	Can be displayed using sysfs command.

config  MV_ETH_STAT_DIST
        bool "Collect debug distribution statistics"
        default n
        ---help---
        Marvell network interface driver collect a lot of statistics.
        Used for Debug mode. Decrease performance.
	Can be displayed using sysfs command.

endmenu

menu "Advanced Features"

config  NET_SKB_HEADROOM
        int "SKB headroom size"
        default 64
        ---help---
          Customize SKB headroom size. Must be power of 2.

config NET_SKB_RECYCLE
        bool "Skb recycle"
        default y
        ---help---
          Work-in-progress and experimental.

          This option enables skb's to be returned via a callback at kfree to
          the allocator to make a fastpath for very skb consuming network
          applications.

config NET_SKB_RECYCLE_DEF
        depends on NET_SKB_RECYCLE
        int "Default value for SKB recycle:  0 - disable, 1 - enable"
        default 1
        ---help---

config  MV_ETH_RX_COAL_PKTS
        int "Threshold [number of packets] for RX interrupt"
        default 32
        ---help---
        Number of packets will be received before RX interrupt will be generated by HW.

config  MV_ETH_RX_COAL_USEC
        int "Threshold [usec] for RX interrupt"
        default 100
        ---help---
        Time delay in usec before RX interrupt will be generated by HW if number of
	received packets larger than 0 but smaller than MV_ETH_RX_COAL_PKTS

endmenu
```

## drivers/net/ethernet/mvebu_net/prestera/Kconfig
```kconfig
config MV_INCLUDE_PRESTERA
	bool "Prestera Switch Support"
	depends on ARCH_MVEBU
#	select MV_INCLUDE_PRESTERA_PCI if MACH_ARMADA_XP_AMC
	default y
	help
	Add Prestera mvPP char device driver support,
	used by user space to configure and interact with
	Prestera Packet Procesors, supporting switches connected
	via PCIe to AMC/AXP and MSYS.
	This option should be enabled when using CPSS.


config MV_INCLUDE_PRESTERA_PCI
	bool "Prestera Switch Support for PCI endpoint"
	depends on MV_INCLUDE_PRESTERA
	default y
	help
	this option increase virtual memory
	allocation in case of ARMADA XP AMC
	board for CPSS devices connected to
	PCI switch

config MV_INCLUDE_PRESTERA_KERNELEXT
	tristate "Prestera mvKernelExt"
	depends on MV_INCLUDE_PRESTERA
	default y
	help
	Add Prestera mvKernelExt char device driver support,
	used by user space to configure and interact with
	Prestera Packet Processors, supporting switches connected
	via PCIe to AMC/AXP and MSYS.
	This option should be enabled when using CPSS.
```

## drivers/pci/ep/Kconfig
```kconfig
menu "PCI End-point controller drivers"
	depends on PCI

config PCIE_A8K_DW_EP
	bool "Armada-8K DesignWare PCI End-point driver "
	depends on OF && HAS_IOMEM
	help
	 Enables support for the Armada-8k DesignWare PCIe end-point controller.
	 The driver enables to configure the end-point BARs and respective
	 address space.

endmenu
```

## drivers/perf/Kconfig
```kconfig
#
# Performance Monitor Drivers
#

menu "Performance monitor support"

config ARM_PMU
	depends on PERF_EVENTS && (ARM || ARM64)
	bool "ARM PMU framework"
	default y
	help
	  Say y if you want to use CPU performance monitors on ARM-based
	  systems.

config MVEBU_SPMU
	depends on ARCH_MVEBU
	bool "Armada-8K SPMU Support"
	default y
	help
	  Enable system PMU for armada-8k SoCs.

endmenu
```

## drivers/staging/gd5f_spinand/Kconfig
```kconfig
config MTD_SPINAND_GD5F
	tristate "SPINAND Device Support for Gigadevice"
	depends on MTD_NAND && SPI
	help
	  This enables support for accessing GigaDevice
	  SPI NAND flash devices.
	  If you have a GigaDevice SPI NAND chip say yes.
	  If unsure, say no here.

config MTD_SPINAND_ONDIEECC
	bool "Use SPINAND internal ECC"
	depends on MTD_SPINAND_GD5F
	help
	  Internal ECC.
	  Enables Hardware ECC support for GigaDevice SPI NAND.
```

## drivers/telephony/Kconfig
```kconfig
#
# Telephony device configuration
#

menuconfig PHONE
	bool "Telephony devices support"
	default y
	---help---
	  Say Y here to get to see options for hardware telephony devices.
	  This option alone does not add any kernel code.

	  If you say N, all options in this submenu will be skipped and disabled.

if PHONE

config MVEBU_PHONE
	bool "Mvebu TDM Telephony"
	depends on ARCH_MVEBU
	default y
	---help---
	  This driver supports the TDM-based telephony interface
	  units in the following Marvell SoC families:
	  1. ARMADA-370.
	  2. ARMADA-375.
	  3. ARMADA-38x.
	  4. ARMADA-XP.
	  5. ARMADA-7k/8k.

if MVEBU_PHONE
	source "drivers/telephony/mvebu_phone/Kconfig"
endif

endif # PHONE
```

## drivers/telephony/mvebu_phone/Kconfig
```kconfig
menu "Marvell Telephony options"
	depends on MVEBU_PHONE

config MV_TDM_EXT_STATS
	bool "Enable legacy TDM extended statistics"
	depends on MACH_ARMADA_38X
	default y
	---help---
	Choosing this option will export
	extended statistics to procfs.
	This is relevant only for the
	legacy TDM unit.

endmenu
```
