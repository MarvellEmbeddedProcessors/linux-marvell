## arch/arm64/configs/mvebu_v8_pd_lsp_defconfig
```kconfig
CONFIG_SYSVIPC=y
CONFIG_FHANDLE=y
CONFIG_NO_HZ_IDLE=y
CONFIG_HIGH_RES_TIMERS=y
CONFIG_BSD_PROCESS_ACCT=y
CONFIG_BSD_PROCESS_ACCT_V3=y
CONFIG_IKCONFIG=y
CONFIG_IKCONFIG_PROC=y
CONFIG_LOG_BUF_SHIFT=14
CONFIG_MEMCG=y
CONFIG_MEMCG_SWAP=y
CONFIG_MEMCG_KMEM=y
# CONFIG_UTS_NS is not set
# CONFIG_IPC_NS is not set
CONFIG_SCHED_AUTOGROUP=y
CONFIG_BLK_DEV_INITRD=y
CONFIG_KALLSYMS_ALL=y
# CONFIG_COMPAT_BRK is not set
CONFIG_PROFILING=y
CONFIG_JUMP_LABEL=y
CONFIG_MODULES=y
CONFIG_MODULE_UNLOAD=y
# CONFIG_BLK_DEV_BSG is not set
# CONFIG_IOSCHED_DEADLINE is not set
CONFIG_ARCH_MVEBU=y
CONFIG_ARCH_MVEBU_PD=y
CONFIG_SCHED_MC=y
CONFIG_HOTPLUG_CPU=y
CONFIG_PREEMPT=y
CONFIG_HZ_20=y
CONFIG_KSM=y
CONFIG_TRANSPARENT_HUGEPAGE=y
CONFIG_CMA=y
CONFIG_CMDLINE="console=ttyAMA0"
# CONFIG_CORE_DUMP_DEFAULT_ELF_HEADERS is not set
CONFIG_COMPAT=y
# CONFIG_SUSPEND is not set
CONFIG_UEVENT_HELPER_PATH="/sbin/hotplug"
CONFIG_DEVTMPFS=y
CONFIG_DEVTMPFS_MOUNT=y
CONFIG_DMA_CMA=y
CONFIG_VEXPRESS_CONFIG=y
CONFIG_BLK_DEV_LOOP=y
CONFIG_BLK_DEV_RAM=y
CONFIG_BLK_DEV_RAM_COUNT=1
CONFIG_BLK_DEV_RAM_SIZE=48000
CONFIG_SCSI=y
# CONFIG_SCSI_PROC_FS is not set
# CONFIG_SCSI_LOWLEVEL is not set
# CONFIG_INPUT_MOUSEDEV is not set
CONFIG_INPUT_EVDEV=y
# CONFIG_INPUT_KEYBOARD is not set
# CONFIG_INPUT_MOUSE is not set
# CONFIG_SERIO_SERPORT is not set
CONFIG_SERIO_AMBAKMI=y
CONFIG_VT_HW_CONSOLE_BINDING=y
CONFIG_LEGACY_PTY_COUNT=16
CONFIG_SERIAL_8250=y
CONFIG_SERIAL_8250_CONSOLE=y
CONFIG_SERIAL_8250_DW=y
CONFIG_SERIAL_AMBA_PL011=y
CONFIG_SERIAL_AMBA_PL011_CONSOLE=y
CONFIG_SERIAL_OF_PLATFORM=y
CONFIG_SERIAL_XILINX_PS_UART=y
CONFIG_SERIAL_XILINX_PS_UART_CONSOLE=y
CONFIG_SERIAL_MVEBU_UART=y
# CONFIG_HW_RANDOM is not set
CONFIG_I2C=y
CONFIG_I2C_CHARDEV=y
CONFIG_I2C_MV64XXX=y
CONFIG_PPS=y
# CONFIG_HWMON is not set
CONFIG_MFD_SYSCON=y
# CONFIG_USB_SUPPORT is not set
CONFIG_DMADEVICES=y
CONFIG_MV_XOR=y
CONFIG_MV_XOR_V2=y
CONFIG_DMATEST=y
CONFIG_COMMON_CLK_VERSATILE=y
CONFIG_CLK_SP810=y
CONFIG_CLK_VEXPRESS_OSC=y
# CONFIG_IOMMU_SUPPORT is not set
CONFIG_RESET_CONTROLLER=y
CONFIG_RAS=y
# CONFIG_DMIID is not set
CONFIG_EXT2_FS=y
CONFIG_EXT2_FS_XATTR=y
CONFIG_EXT3_FS=y
CONFIG_FANOTIFY=y
CONFIG_FANOTIFY_ACCESS_PERMISSIONS=y
CONFIG_QUOTA=y
CONFIG_AUTOFS4_FS=y
CONFIG_FUSE_FS=y
CONFIG_CUSE=y
CONFIG_TMPFS=y
# CONFIG_EFIVAR_FS is not set
# CONFIG_MISC_FILESYSTEMS is not set
CONFIG_NLS_CODEPAGE_437=y
CONFIG_NLS_ISO8859_1=y
CONFIG_PRINTK_TIME=y
CONFIG_DEBUG_INFO=y
CONFIG_DEBUG_FS=y
CONFIG_MAGIC_SYSRQ=y
CONFIG_DEBUG_KERNEL=y
CONFIG_LOCKUP_DETECTOR=y
# CONFIG_SCHED_DEBUG is not set
# CONFIG_DEBUG_PREEMPT is not set
# CONFIG_FTRACE is not set
CONFIG_MEMTEST=y
CONFIG_KEYS=y
CONFIG_SECURITY=y
CONFIG_CRYPTO_ANSI_CPRNG=y
CONFIG_ARM64_CRYPTO=y
CONFIG_CRYPTO_SHA1_ARM64_CE=y
CONFIG_CRYPTO_SHA2_ARM64_CE=y
CONFIG_CRYPTO_GHASH_ARM64_CE=y
CONFIG_CRYPTO_AES_ARM64_CE_CCM=y
CONFIG_CRYPTO_AES_ARM64_CE_BLK=y
CONFIG_CRYPTO_AES_ARM64_NEON_BLK=y
CONFIG_CRYPTO_CRC32_ARM64=y
CONFIG_CRC_ITU_T=y
CONFIG_CRC7=y
CONFIG_LIBCRC32C=y
```

## drivers/crypto/mvebu_cesa/Kconfig
```kconfig
menu "Cesa options"
	depends on MV_INCLUDE_CESA

config  MV_CESA
	bool "Support for Marvell Cryptographic Engine and Security Acceleration(CESA)"
	default y

config  MV_CESA_TOOL_ARMADA
	bool "Support for Marvell CESA Tool"
	default y
	depends on MV_CESA
	select MV_CESA_TOOL
	---help---

config MV_CESA_CHANNELS
	int "Total CESA HW channels supported"
	depends on MV_CESA
	range 1 2
	default "2"
	---help---
	Select the number of CESA channels to be used for crypto operations acceleration.

choice
	prompt "CESA Features"
	depends on MV_CESA
	default MV_CESA_INT_COALESCING_SUPPORT

config MV_CESA_CHAIN_MODE
	bool "Support CESA chain-mode"
	depends on MV_CESA
	---help---
	Choosing this option will enable CESA chain mode support.

config MV_CESA_INT_COALESCING_SUPPORT
	bool "Support Interrupt Coalescing"
	depends on MV_CESA
	---help---
	Choosing this option will enable CESA interrupt coalescing support.

config MV_CESA_INT_PER_PACKET
	bool "Support interrupt per packet(no optimization)"
	depends on MV_CESA
	---help---
	Choosing this option will enforce CESA to work in interrupt per packet mode.

endchoice

config	MV_CESA_INT_COAL_THRESHOLD
	hex "Cryptographic Interrupt Coalescing Threshold"
	depends on MV_CESA_INT_COALESCING_SUPPORT
	range 0x0 0xff
	default 0x2
	---help---
	This field provides a way to minimize the number of interrupts to off load
	the CPU. It defines the number of <AccAndTDMAInt_CM> indications before
	asserting the <EopCoalInt> bit in the Cryptographic interrupt Cause Register.

config	MV_CESA_INT_COAL_TIME_THRESHOLD
	hex "Cryptographic Interrupt Coalescing Time Threshold"
	depends on MV_CESA_INT_COALESCING_SUPPORT
	range 0x0 0xffffff
	default 0xfffff
	---help---
	This field provides a way to ensure maximum delay between <AccAndTDMAInt_CM>
	assertion and assertion bit <EopCoalInt> in Cryptographic Interrupt Cause
	Register (even if the number of <AccAndTDMAInt_CM> indications did not
	reach the <EopCoalPacketTh> value).

config  MV_CESA_TOOL
	depends on MV_CESA_TOOL_ARMADA
	tristate

endmenu
```

## drivers/misc/mvebu/Kconfig
```kconfig
# MISC MVEBU

config MVEBU_SOC_INFO
	bool "Marvell Aramda-8K SoC information driver"
	depends on ARCH_MVEBU
	default y
	help
	  Marvell A8K SoC information driver

config MVEBU_A8K_DEBUGFS
	bool "Marvell Aramda-8K debugfs driver"
	depends on ARCH_MVEBU && ARM64
	default y
	help
	  Debugfs interface for Marvell's Armada-8K SoCs.
	  This drivers provide access (status and configuration) to
	  some SoC status and configuration registers.
```

## drivers/mtd/nand/mvebu_nfc/Kconfig
```kconfig
config MTD_NAND_MARVELL
	bool "NAND Flash support for Marvell Armada SoC"
	depends on MACH_ARMADA_370_XP
	default y
	help
	  This option enables the
	  MTD support for NAND
	  Flash on Marvell Armada
	  machines.

config MTD_NAND_NFC
	tristate "MTD driver for the Armada Nand Flash Controller"
	depends on MTD_NAND_MARVELL
	default y
	help
	  This enables the driver
	  for the NAND flash controller
	  found in the Marvell
	  Armada SoC devices.

config MTD_NAND_NFC_GANG_SUPPORT
	bool "NAND Ganged mode support for the NFC"
	depends on MTD_NAND_NFC
	default n
	help
	  This option enables the support for 2x8bit ganged mode in
	  Marvell's NFC HAL driver and the MTD stack.

config MTD_NAND_NFC_MLC_SUPPORT
	bool "NAND MLC devices support for the NFC"
	depends on MTD_NAND_NFC
	default y
	help
	  This option allows support for Nand devices with non-standard
	  page/oob layout. These devices are detected incorrectly with
	  standard autodetection mechanism based on the READ_ID command.

config MTD_NAND_NFC_INIT_RESET
	bool "NAND Enable Reset on Initialization"
	depends on MTD_NAND_NFC
	default y
	help
	  This option forces NAND reset command on initialization. This
	  is required by certain NAND vendors (Micron).

config MTD_NAND_NFC_NEGLECT_RNB
	bool "NAND Neglect Read/Busy Signal"
	depends on MTD_NAND_NFC
	default n
	help
	  This option forces allows operation withou the RnBx signal. In this
	  mode, tR taken as worst case in every operation
```

## drivers/net/ethernet/marvell/pp3/Kconfig
```kconfig
config MVPP3
	tristate "Marvell Armada 390 network interface support"
	depends on ARCH_MVEBU
	select MVMDIO
	select MV_GNSS_SUPPORT
	select MVEBU_ODMI
	select MVNET_COMPLEX
	---help---
		Add support for PP3 driver.
		This driver supports the network
		interface units in the Marvell
		ARMADA 39x SoC.

config MV_GNSS_SUPPORT
	bool "Generic NSS network interfaces support"
	depends on MVPP3
	default n
	---help---
	When defined add support for generic
	NSS capabilities.
	When not defined only standard network
	inferfaces are supported.

config MV_PP3_TM_SUPPORT
	bool "Traffic Management (TM) configuration support"
	depends on MVPP3
	default y
	---help---
	When defined add support for run-time configuration of Traffic Management
	hardware capabilities.
	When not defined hardware default values will be used.
	If unsure, say N.

menu "BM configuration"
	depends on MVPP3

config MV_PP3_BM_LINUX_POOL_CAPACITY
	int "capacity of Linux (TxDone) BM pool"
	default 16384
	---help---
	Number of buffers can be returned to pool after transmit.
	BM Linux pools are created for each CPU for all interfaces.
	All BM Linux pools are empty after initialization.
	Hardware will push buffers to these pools when transmit is completed.
	Software will pop buffers from these pools and return these buffers to Linux.

config MV_PP3_BM_RX_POOL_CAPACITY
	int "capacity of Receive BM pools"
	default 32768
	---help---
	Maximal number of buffers can pushed to BM long or short pool.
	Buffers are allocated for BM pools during initialization.
	Capacity of BM pools must be bigger then number of buffers that allocated for long or short pools.

config MV_PP3_BM_SHORT_BUF_SIZE
	int "buffers size for BM short pool"
	default 0
	---help---
	Default size of buffers allocated for short pools.
	Buffers size should be long enough to contain the predefined headroom
	and linux shared info.
	This value is relevant for all ports.

endmenu

menu "Rx/Tx Queue configuration"
	depends on MVPP3

config  MV_PP3_RXQ_NUM
	int "Number of RX VQs for NIC devices"
        default 2
        ---help---
	Number of virtual RXQs for each NIC network interface

config  MV_PP3_GNSS_RXQ_NUM
	int "Number of RX VQs for NSS devices"
        default 2
        ---help---
	Number of virtual RXQs for each NSS network interface

config MV_PP3_RXQ_SIZE
	int "Number of CFHs [128 bytes] allocated for each RXQ"
	default 1024
        ---help---
	Default number of CFHs [128 bytes] in each RXQ.
	This value is relevant for all RXQs.

config  MV_PP3_TXQ_NUM
	int "Number of TX VQs for NIC devices"
        default 2
        ---help---
	Number of virtual TXQs for each NIC network interface

config  MV_PP3_GNSS_TXQ_NUM
	int "Number of TX VQs for NSS devices"
        default 2
        ---help---
	Number of virtual TXQs for each NSS network interface

config MV_PP3_TXQ_SIZE
	int "Number of CFHs [128 bytes] allocated for each TXQ"
	default 2048
        ---help---
	Default number of CFHs [128 bytes] in each TXQ.
	This value is relevant for all TXQs.

endmenu

menu "Control and Statistics"
	depends on MVPP3

config  MV_PP3_DEBUG_CODE
	bool "Add run-time debug code"
	default y
	---help---
	When defined special debug code is compiled in kernel image.
	Some debug messages can be enabled/disabled using special sysfs command.
	Used for Debug mode and can cause performance decrease.
	Minory increase kernal image size.

config  MV_PP3_STAT_ERR
	bool "Collect error statistics"
	default y
	---help---
	Marvell network interface driver collect minimal number of statistics.
	Provide information only about error events. Doesn't effect performance.
	Can be displayed using sysfs commands.

config  MV_PP3_STAT_INF
	bool "Collect event statistics"
	default y
	---help---
	Marvell network interface driver collect event statistics.
	Provide more information about driver functionality and almost doesn't
	effect performance. Can be displayed using sysfs command.

config  MV_PP3_STAT_DBG
	bool "Collect debug statistics"
	default y
	---help---
	Marvell network interface driver collect a lot of statistics.
	Provide information about each event occurs in the driver.
	Used for Debug mode and can cause performance decrease.
	Can be displayed using sysfs command.

endmenu

menu "Advanced Features"
	depends on MVPP3

config MV_PP3_SKB_RECYCLE
	depends on NET_SKB_RECYCLE
	bool "PP3 SKB recycle only for forwarding cases"
	default y
	---help---
	Work-in-progress and experimental.

	This option enables skb's to be recycled after packet transmitted,
	which makes a fastpath for routine and bridge skb consuming network
	applications. It only applies to nic interfaces.

config MV_PP3_SKB_RECYCLE_DEF
	depends on MV_PP3_SKB_RECYCLE
	int "Default value for SKB recycle:  0 - disable, 1 - enable"
	default 0
	---help---
	SKB recycle can be enabled or disabled in run-time by sysfs command:
	"echo [0|1] > dev/nic_skb" - set SKB recycle in NIC mode, 0 - disable, 1 - enable

config  MV_PP3_RX_COAL_PKTS
        int "Threshold [number of packets] for RX interrupt"
        default 32
        ---help---
        Number of packets will be received before RX interrupt will be generated by HW.

config  MV_PP3_RX_COAL_USEC
        int "Threshold [usec] for RX interrupt"
        default 100
        ---help---
        Time delay in usec before RX interrupt will be generated by HW if number of
	received packets larger than 0 but smaller than MV_PP3_RX_COAL_PKTS

config  MV_PP3_TXDONE_COAL_PKTS
        int "Threshold for TX_DONE event trigger"
        default 16
        ---help---
	Number of packets will be sent before TX_DONE event will be triggered.

config MV_PP3_TXDONE_IN_HRTIMER
        depends on HIGH_RES_TIMERS
        bool "Use high resolution timer to process TX_DONE event"
        ---help---
        When chosen TX_DONE event will be process by high resolution timer in polling mode.
        High resolution timer can support higher precision in ns level.
        If high resolution timer is enabled, TX processing
	 can free SKB memory much faster.

config  MV_PP3_GRO
        bool "GRO Support for Marvell network interface"
	default y
        ---help---
	Marvell network driver compiled with GRO (Generic Receive Offload) support.

config  MV_PP3_SG
        bool "Scatter-Gather Support for Marvell network interface"
        default n
        ---help---
        Marvell network driver compiled with SG (Scatter-Gather Offload) support.

config  MV_PP3_TSO
	depends on MV_PP3_SG
        bool "TSO Support for Marvell network interface"
	default n
        ---help---
	Marvell PP3 network driver compiled with TSO support
	(TSO -- TCP Segmentation Offloading)
	L4 checksum offload must be enabled

config  MV_PP3_PPC_NUM
        int "Number of active packet processors clusters"
        default 2
        ---help---
	Number of active packet processors clusters in the system.

config  MV_PP3_PTP_SERVICE
	bool "PTP service"
	default y
	select UIO
	---help---
	PTP uio mapping and packet-timestamp in Marvell network driver

endmenu
```
