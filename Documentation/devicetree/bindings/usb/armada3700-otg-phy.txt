## Documentation/devicetree/bindings/usb/armada3700-otg-phy.txt
```
USB Armada3700 OTG PHY

This controller is integrated only in Armada-3700.

Armada-3700 could be working in USB OTG mode which supports USB Host/Device mode
switching dynamically. To do that, the following dts changes are required:
- Enable both USB Host (usb3) and Device (u3d and udc) controller DT nodes.
- In USB Host DT node, use special XHCI driver compatible string:
  "marvell,armada-3700-xhci-otg", while the default one "generic-xhci" is for
  USB Host only mode.
- Enable OTG PHY TD node and make sure XHCI DT node have reference to it with
  "usb-phy" property.

Required properties:
- compatible	: should be "marvell,armada-3700-otg"
- reg		: Physical base address and size of the USB3 device registers map.
- interrupts	: Should contain single irq line of USB3 device controller

Optional properties:
- vcc-supply: phandle to the regulator that provides power to the PHY.

Example:
	usb3@58000 {
		compatible = "marvell,armada-3700-xhci-otg";
		status = "okay";
		usb-phy = <&otg_phy>;
	};

	otg_phy: otg@5d800 {
		compatible = "marvell,usb-3700-otg";
		reg = <0x5d800 0x100>;
		interrupts = <GIC_SPI 16 IRQ_TYPE_LEVEL_HIGH>;
		vcc-supply = <&exp_usb3_vbus>;
		status = "okay";
	};
```

## Documentation/devicetree/bindings/usb/armada3700-usb-phy.txt
```
USB Armada3700 OTG PHY

This controller is integrated only in Armada-3700.

Armada-3700 could be working in USB OTG mode which supports USB Host/Device mode
switching dynamically. To do that, the following dts changes are required:
- Enable both USB Host (usb3) and Device (u3d and udc) controller DT nodes.
- Enable OTG PHY TD node and make sure XHCI DT node have reference to it with
  "usb-phy" property.
Armada-3700 could also be working in USB static host mode, when USB Device feature
is not required.

Required properties:
- compatible	: should be "marvell,armada-3700-usb-phy"
- reg		: Physical base address and size of the USB3 device registers map.
- interrupts	: Should contain single irq line of USB3 device controller

Optional properties:
- vcc-supply: phandle to the regulator that provides power to the PHY.
- marvell,static-host-mode: OTG PHY is working in usb static host mode, with no host/device
  switching supported.

USB OTG mode example:
	usb_phy: usb_phy@5d800 {
		compatible = "marvell,armada-3700-usb-phy";
		reg = <0x5d800 0x100>;
		interrupts = <GIC_SPI 16 IRQ_TYPE_LEVEL_HIGH>;
		vcc-supply = <&exp_usb3_vbus>;
		status = "okay";
	};

USB Static Host mode example:
	usb_phy: usb_phy@5d800 {
		compatible = "marvell,armada-3700-usb-phy";
		reg = <0x5d800 0x100>;
		interrupts = <GIC_SPI 16 IRQ_TYPE_LEVEL_HIGH>;
		marvell,static-host-mode;
		vcc-supply = <&exp_usb3_vbus>;
		status = "okay";
	};
```

## Documentation/devicetree/bindings/usb/ehci-orion.txt
```
* EHCI controller, Orion Marvell variants

Required properties:
- compatible: could be one of the followings
	"marvell,orion-ehci"
	"marvell,armada-3700-ehci"
- reg: physical base address of the controller and length of memory mapped
  region.
- interrupts: The EHCI interrupt

Optional properties:
- clocks: reference to the clock
- phys: reference to the USB PHY
- phy-names: name of the USB PHY, should be "usb"
- needs-reset-on-resume: boolean, set this to force EHCI reset after resume,
  for example, Armada 3700 should force EHCI reset after resume to insure
  data traffic continuity

Examples:

	ehci@50000 {
		compatible = "marvell,orion-ehci";
		reg = <0x50000 0x1000>;
		interrupts = <19>;
	};

	usb@5e000 {
		compatible = "marvell,armada-3700-ehci";
		reg = <0x5e000 0x1000>;
		interrupts = <GIC_SPI 17 IRQ_TYPE_LEVEL_HIGH>;
		phys = <&utmi_usb2>;
		phy-names = "usb";
		needs-reset-on-resume;
	};
```

## Documentation/devicetree/bindings/usb/marvell,mv-udc.txt
```
Marvell mv_udc gadget

Required properties:
  - compatible : should be "marvell,mv_udc".
  - reg : address and length of the register set for the device.
  - interrupts : one interrupt should be described here.
  - clocks : clock number to enable.

Example:
	udc@58100 {
		  compatible = "marvell,mv-udc";
		  reg = <0x58100 0x2000>;
		  interrupts = <0 18 0x4>;
		  clocks = <&gateclk 18>;
	};
```

## Documentation/devicetree/bindings/usb/marvell-u3d.txt
```
Marvell USB3 device controller

This controller is integrated in Armada 38x/3700/8K.

Required properties:
- compatible	: Must be "marvell,mvebu-u3d" except Armada 3700,
		  for Armada 3700 it is "marvell,armada3700-u3d".
- reg		: Physical base address and size of the USB3 device registers map.
- interrupts	: Should contain single irq line of USB3 device controller
- clocks	: the clock associated to this controller
- dma-coherent	: if controller is DMA coherent

Optional properties :
- vbus-gpio	: VBUS interrupt GPIO pin
		  set to trigger VBUS event notification to PHY/controller
		  whether VBUS was powered or not
- phys		: the COMPHY associated to this controller
- phy-names:	: the name of COMPHY indicated by above property of phys

Example for all SoCs, except Armada-3700:
	u3d@520000 {
		compatible = "marvell,mvebu-u3d";
		reg = <0x520000 0x2000>;
		interrupts = <GIC_SPI 60 IRQ_TYPE_LEVEL_HIGH>;
		clocks = <&gateclk 24>, <&gateclk 16>;
		dma-coherent;
		vbus-gpio = <&gpio1 19 GPIO_ACTIVE_HIGH>;
		phys = <&a3700_comphy 1 COMPHY_USB3>;
		phy-names = "usb";
		status = "disabled";
	};

Example for Armada-3700:
	u3d@50000 {
		compatible = "marvell,armada3700-u3d";
		/* 0: 0x50000: USB 3.0 Device port 0: DEV_INFO_REG(0:15 - version_id) */
		reg = <0x50000 0x2000>;
		interrupts = <GIC_SPI 15 IRQ_TYPE_LEVEL_HIGH>;
		clocks = <&sgateclk 17>;
		status = "disabled";
	};
```

## Documentation/devicetree/bindings/usb/marvell-udc.txt
```
Marvell USB2 device controller

This controller is integrated in Armada 38x/3700/8K.

Required properties:
- compatible	: Must be "marvell,mv-udc"
- reg		: Physical base address and size of the USB2 device registers map.
- interrupts	: Should contain single irq line of USB2 device controller
- clocks	: the clock associated to this controller
- dma-coherent	: if controller is DMA coherent

Optional properties :
- vbus-gpio	: VBUS interrupt GPIO pin
		  set to trigger VBUS event notification to PHY/controller
		  whether VBUS was powered or not
- phys		: the UTMI PHY associated to this controller
- phy-names	: the name of UTMI PHY indicated by above property

Example:
	udc@524100 {
		compatible = "marvell,mv-udc";
		reg = <0x524100 0x2000>;
		interrupts = <GIC_SPI 60 IRQ_TYPE_LEVEL_HIGH>;
		clocks = <&gateclk 24>, <&gateclk 16>;
 		dma-coherent;
		vbus-gpio = <&gpio1 19 GPIO_ACTIVE_HIGH>;
		phys = <&utmi_usb32>;
		phy-names = "usb";
		status = "disabled";
	};
```

## Documentation/devicetree/bindings/usb/usb-xhci.txt
```
USB xHCI controllers

Required properties:
  - compatible: should be one of "generic-xhci",
    "marvell,armada-375-xhci", "marvell,armada-380-xhci",
    "renesas,xhci-r8a7790", "renesas,xhci-r8a7791",
    "marvell,armada-3700-xhci" (deprecated: "xhci-platform").
  - reg: should contain address and length of the standard XHCI
    register set for the device.
  - interrupts: one XHCI interrupt should be described here.

Optional properties:
  - clocks: reference to a clock
  - usb3-lpm-capable: determines if platform is USB3 LPM capable
  - separated-phys-for-usb2-usb3: it is set when usb3 host controller
    uses separated PHYs for USB 2 and USB 3 - a dedicated utmi phy
    for USB 2 and another phy for USB 3, for example, Armada 3700
    usb3 controller uses a dedicated utmi phy for USB 2 and a comphy
    for USB 3
  - phys: phandle + phy specifier pair, reference to the USB PHYs
  - phy-names: can be "usb2", "usb3" when "separated-phys-for-usb2-usb3" is
    set or "usb" when "separated-phys-for-usb2-usb3" is not set.
  - needs-reset-on-resume: boolean, set this to force XHCI reset after resume,
    for example, Armada 3700 must force XHCI reset after resume

Examples:
	usb@f0931000 {
		compatible = "generic-xhci";
		reg = <0xf0931000 0x8c8>;
		interrupts = <0x0 0x4e 0x0>;
	};

	For Armada 3700 which uses separated PHYs for USB 2 and USB 3:
	usb3@58000 {
		compatible = "marvell,armada-3700-xhci";
		reg = <0x58000 0x4000>;
		interrupts = <GIC_SPI 3 IRQ_TYPE_LEVEL_HIGH>;
		clocks = <&sgateclk 17>;
		usb-phy = <&usb_phy>;
		phys = <&utmi_usb32>, /* utmi usb32 dedicated phy */
		       <&a3700_comphy 1 COMPHY_USB3>; /* usb3 comphy */
		phy-names = "usb2", "usb3";
		separated-phys-for-usb2-usb3;
		needs-reset-on-resume;
	};
```

## Documentation/devicetree/bindings/watchdog/armada3700-wdt.txt
```
* Armada37x0 Watchdog driver : Watchdog driver used in Marvell Armada37x0 SoC

Required properties:

- compatible : should be "marvell,armada-3700-wdt"
- reg : base addresses and lengths of the watchdog control register and global counter registers.
	watchdog control register point to the CPU watchdog timer select register, while global
	counter register points to the timers referred by watchdog.
- clocks: input clock of watchdog timer.

Example:

wdt: watchdog-timer@8300 {
	compatible = "marvell,armada-3700-wdt";
	reg = <0xd064 0x4>,
	      <0x8300 0x40>;
	clocks = <&osc>;
};
```

## arch/arm/configs/mvebu_extra_defconfig
```kconfig
CONFIG_POSIX_MQUEUE=y
CONFIG_POSIX_MQUEUE_SYSCTL=y
CONFIG_FHANDLE=y
CONFIG_CGROUPS=y
CONFIG_CGROUP_FREEZER=y
CONFIG_CGROUP_DEVICE=y
CONFIG_CPUSETS=y
CONFIG_PROC_PID_CPUSET=y
CONFIG_CGROUP_CPUACCT=y
CONFIG_RESOURCE_COUNTERS=y
CONFIG_MEMCG=y
CONFIG_MEMCG_SWAP=y
CONFIG_MEMCG_SWAP_ENABLED=y
CONFIG_MEMCG_KMEM=y
CONFIG_CGROUP_SCHED=y
CONFIG_FAIR_GROUP_SCHED=y
CONFIG_CFS_BANDWIDTH=y
CONFIG_RT_GROUP_SCHED=y
CONFIG_BLK_CGROUP=y
CONFIG_NAMESPACES=y
CONFIG_UTS_NS=y
CONFIG_IPC_NS=y
CONFIG_PID_NS=y
CONFIG_NET_NS=y
CONFIG_MM_OWNER=y
CONFIG_PERF_EVENTS=y
CONFIG_HAVE_HW_BREAKPOINT=y
CONFIG_GPIO_PCA953X=y
CONFIG_HW_PERF_EVENTS=y
CONFIG_NETFILTER=y
CONFIG_NETFILTER_ADVANCED=y
CONFIG_BRIDGE_NETFILTER=y
CONFIG_MAC80211=y
CONFIG_MAC80211_HAS_RC=y
CONFIG_MAC80211_RC_PID=y
CONFIG_MAC80211_RC_MINSTREL=y
CONFIG_MAC80211_RC_MINSTREL_HT=y
CONFIG_MAC80211_RC_DEFAULT_MINSTREL=y
CONFIG_BLK_DEV_LOOP=y
CONFIG_MACVLAN=y
CONFIG_MACVTAP=y
CONFIG_VXLAN=y
CONFIG_VETH=y
CONFIG_DEVPTS_MULTIPLE_INSTANCES=y
CONFIG_REGULATOR=y
CONFIG_REGULATOR_FIXED_VOLTAGE=y
CONFIG_USB_PHY=y
CONFIG_NOP_USB_XCEIV=y
CONFIG_MV_TDM_EXT_STATS=y
CONFIG_FS_POSIX_ACL=y
CONFIG_NTFS_FS=y
CONFIG_NFSD_V4=y
CONFIG_SUNRPC_GSS=y
CONFIG_CRYPTO_ARC4=y
CONFIG_AVERAGE=y
CONFIG_OID_REGISTRY=y
```

## arch/arm/mach-mvebu/Kconfig
```kconfig
config ARCH_MVEBU
	bool "Marvell SOCs with Device Tree support" if ARCH_MULTI_V7
	select CLKSRC_MMIO
	select COMMON_CLK
	select GENERIC_CLOCKEVENTS
	select GENERIC_IRQ_CHIP
	select IRQ_DOMAIN
	select MULTI_IRQ_HANDLER
	select PINCTRL
	select PLAT_ORION
	select SPARSE_IRQ
	select CLKDEV_LOOKUP
	select MVEBU_CLK_CORE
	select MVEBU_CLK_CPU
	select MVEBU_CLK_GATING
	select MVEBU_CLK_COREDIV
	select MVEBU_MBUS
	select ZONE_DMA if ARM_LPAE
	select ARCH_REQUIRE_GPIOLIB
	select MIGHT_HAVE_PCI
	select PCI_QUIRKS if PCI
	select RESET_CONTROLLER

if ARCH_MVEBU

menu "Marvell SOC with device tree"

config MACH_ARMADA_370_XP
	bool
	select ARMADA_370_XP_TIMER
	select HAVE_SMP
	select CACHE_L2X0
	select CPU_PJ4B

config MACH_ARMADA_370
	bool "Marvell Armada 370 boards"
	select MACH_ARMADA_370_XP
	select PINCTRL_ARMADA_370
	help
	  Say 'Y' here if you want your kernel to support boards based
	  on the Marvell Armada 370 SoC with device tree.

config MACH_ARMADA_375
	bool "Marvell Armada 375 boards"
	select ARM_ERRATA_720789
	select ARM_ERRATA_753970
	select ARM_NEEDS_SMP_COHERENCY_ON_UP
	select ARM_GIC
	select ARMADA_370_XP_TIMER
	select CACHE_L2X0
	select CPU_V7
	select HAVE_SMP
	select HAVE_ARM_SCU
	select HAVE_ARM_TWD if LOCAL_TIMERS
	select NEON
	select PINCTRL_ARMADA_375
	select USB_ARCH_HAS_XHCI
	help
	  Say 'Y' here if you want your kernel to support boards based
	  on the Marvell Armada 375 SoC with device tree.

config MACH_ARMADA_380
	bool "Marvell Armada 380/385 boards"
	select USB_ARCH_HAS_XHCI
	select ARM_ERRATA_720789
	select ARM_ERRATA_753970
	select ARM_NEEDS_SMP_COHERENCY_ON_UP
	select ARM_GIC
	select ARMADA_370_XP_TIMER
	select CACHE_L2X0
	select CPU_V7
	select HAVE_SMP
	select HAVE_ARM_SCU
	select HAVE_ARM_TWD if LOCAL_TIMERS
	select NEON
	select PINCTRL_ARMADA_38X
	select USB_ARCH_HAS_XHCI
	help
	  Say 'Y' here if you want your kernel to support boards based
	  on the Marvell Armada 380/385 SoC with device tree.

config MACH_ARMADA_XP
	bool "Marvell Armada XP boards"
	select MACH_ARMADA_370_XP
	select PINCTRL_ARMADA_XP
	help
	  Say 'Y' here if you want your kernel to support boards based
	  on the Marvell Armada XP SoC with device tree.

config A375_CPU1_ENABLE_WA
	depends on SMP
	bool "SMP CPU1 Enable WA"
	default y

config A375_Z1_USB3_LFPS_FREQ_WA
	bool "Enable the LFPS frequency workaround for USB3"
	default y
	help

	  This flag enables a workaround for USB3 in Armada 375. It fixes
	  the USB3 LFPS timing to fix some clock issues in the integration
	  of USB3. This WA is needed only for Z1 devices

endmenu

endif
```
