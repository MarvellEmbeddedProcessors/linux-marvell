## Documentation/devicetree/bindings/arm/armada-370-xp-pmsu.txt
```
Power Management Service Unit(PMSU)
-----------------------------------

Available on Marvell SOCs: Armada XP

Required properties:

- compatible: "marvell,armada-370-xp-pmsu"

- reg: Should contain the location and length of the PMSU registers.

Example:

armada-370-xp-pmsu@22100 {
	compatible = "marvell,armada-370-xp-pmsu";
	reg = <0x22100 0x400>;
};
```

## Documentation/devicetree/bindings/arm/armada-375-usb-cluster.txt
```
Armada 375 USB cluster
----------------------

Armada 375 comes with an USB2 host and device controller and an USB3
controller. The USB cluster control register allows to manage common
features of both USB controllers.

Required properties:

- compatible: "marvell,armada-375-usb-cluster"
- reg: Should contain usb cluster register location and length.

Example:
	usb-cluster@18400 {
		compatible = "marvell,armada-375-usb-cluster";
		reg = <0x18400 0x4>;
	};
```

## Documentation/devicetree/bindings/arm/coherency-fabric.txt
```
Coherency fabric
----------------
Available on Marvell SOCs: Armada 370, Armada 375 and Armada XP

Required properties:

- compatible: the possible values are:

 * "marvell,coherency-fabric", kept for backward compatibility reasons
   only. To be used for the coherency fabric of the Armada 370 and
   Armada XP. It is recommended to use
   "marvell,armada-370-coherency-fabric" instead.

 * "marvell,armada-370-coherency-fabric", for the Armada 370 and
   Armada XP coherency fabric.

 * "marvell,armada-375-coherency-fabric", for the Armada 375 coherency
   fabric.

- reg: Should contain coherency fabric registers location and
  length.

 * For "marvell,coherency-fabric" and
   "marvell,armada-370-coherency-fabric", the first pair for the
   coherency fabric registers, second pair for the per-CPU fabric
   registers.

 * For "marvell,armada-375-coherency-fabric", only one pair is needed
   for the per-CPU fabric registers.


Examples:

coherency-fabric@d0020200 {
	compatible = "marvell,armada-370-coherency-fabric";
	reg = <0xd0020200 0xb0>,
		<0xd0021810 0x1c>;

};

coherency-fabric@21810 {
	compatible = "marvell,armada-375-coherency-fabric";
	reg = <0x21810 0x1c>;
};
```

## Documentation/devicetree/bindings/arm/marvell/ap806-system-controller.txt
```
Marvell Armada AP806 System Controller
======================================

The AP806 is one of the two core HW blocks of the Marvell Armada 7K/8K
SoCs. It contains a system controller, which provides a number
registers giving access to numerous features: clocks, pin-muxing and
many other SoC configuration items. This DT binding allows to describe
this system controller.

The Device Tree node representing the AP806 system controller provides
a number of clocks:

 - 0: clock of CPU cluster 0
 - 1: clock of CPU cluster 1
 - 2: fixed PLL at 1200 Mhz
 - 3: MSS clock, derived from the fixed PLL
 - 4: eMMC clock, derived from the fixed PLL
 - 5: AP DCLK, derived from sample-at-reset configuration.
 - 6: AP ring clock. always double the DCLK
 - 7: AP external ring clock. half the ring clock.

Required properties:

 - compatible: must be:
     "marvell,ap806-system-controller", "syscon"
 - reg: register area of the AP806 system controller
 - #clock-cells: must be set to 1
 - clock-output-names: must be defined to:
   "ap-cpu-cluster-0", "ap-cpu-cluster-1", "ap-fixed", "ap-mss", "ap-emmc", "ap-dclk",
   "ap-rclk", "ap-ext-rclk"
Example:

	syscon: system-controller@6f4000 {
		compatible = "marvell,ap806-system-controller", "syscon";
		#clock-cells = <1>;
		clock-output-names = "ap-cpu-cluster-0", "ap-cpu-cluster-1",
				     "ap-fixed", "ap-mss", "ap-emmc", "dp-hclk",
				     "ap-rclk", "ap-ext-rclk";
		reg = <0x6f4000 0x1000>;
	};
```

## Documentation/devicetree/bindings/arm/marvell/ap810-system-controller.txt
```
Marvell Armada AP810 System Controller
======================================

The AP810 is one of the two core HW blocks of the Marvell Armada 8K+
SoCs. It contains a system controller, which provides a number
registers giving access to numerous features: clocks, pin-muxing and
many other SoC configuration items. This DT binding allows to describe
this system controller.

For the top level node:
 - compatible: must be: "syscon", "simple-mfd";
 - reg: register area of the AP810 system controller

Clocks:
-------

The Device Tree node representing the AP810 system controller provides
a number of clocks:

 - 0: clock of CPU clusters 0 and 1
 - 1: clock of CPU clusters 2 and 3
 - 2: ring PLL used for Aurora 2 fabric
 - 3: DMA clock used for DMA0 - DMA3 engines
 - 4: EIP197 clock produced by IO PLL for driving EIP197d engine
 - 5: fixed PLL at 1200 Mhz
 - 6: MSS clock, derived from the fixed PLL used by SPI, UART, I2C and timers
 - 7: SDIO clock for eMMC/SD interface

Required properties:

 - compatible: must be: "marvell,ap810-clock"
 - #clock-cells: must be set to 1

Pinctrl:
--------

For common binding part and usage, refer to
Documentation/devicetree/bindings/pinctrl/marvell,mvebu-pinctrl.txt.

Required properties:
- compatible must be "marvell,ap810-pinctrl",

Available mpp pins/groups and functions:
Note: brackets (x) are not part of the mpp name for marvell,function and given
only for more detailed description in this document.

name	pins	functions
================================================================================
mpp0	0	gpio, sdio(clk), i2c1(sda)
mpp1	1	gpio, sdio(cmd), i2c1(sck)
mpp2	2	gpio, sdio(d0),  uart1(rxd)
mpp3	3	gpio, sdio(d1)
mpp4	4	gpio, sdio(d2),  uart1(txd)
mpp5	5	gpio, sdio(d3)
mpp6	6	gpio, sdio(ds),  spi0(cs1n)
mpp7	7	gpio, sdio(d4),  spi0(clk)
mpp8	8	gpio, sdio(d5),  spi0(miso)
mpp9	9	gpio, sdio(d6),  spi0(mosi)
mpp10	10	gpio, sdio(d7),  spi0(cs0n)
mpp11	11	gpio, uart0(txd)
mpp12	12	gpio, sdio(pw_off), sdio(hw_rst)
mpp13	13	gpio, mss_gpio
mpp14	14	gpio, mss_gpio, sdio(v18_en)
mpp15	15	gpio, mss_gpio
mpp16	16	gpio, mss_gpio
mpp17	17	gpio, mss_gpio
mpp18	18	gpio, mss_gpio, i2c0(sda)
mpp19	19	gpio, mss_gpio, i2c0(sck), sdio(pw_off)
mpp20	20	gpio, mss_gpio, uart0(rxd)

GPIO:
-----
For common binding part and usage, refer to
Documentation/devicetree/bindings/gpio/gpio-mvebu.txt.

Required properties:

- compatible: "marvell,armada-8kp-gpio"

- offset: offset address inside the syscon block

Example:
ap_syscon: system-controller@6f4000 {
	compatible = "syscon", "simple-mfd";
	reg = <0x6f4000 0x2000>;

	ap_clk: clock {
		compatible = "marvell,ap810-clock";
		#clock-cells = <1>;
	};

	ap_pinctrl: pinctrl {
		compatible = "marvell,ap810-pinctrl";
	};

	ap_gpio: gpio {
		compatible = "marvell,armada-8kp-gpio";
		offset = <0x1040>;
		ngpios = <20>;
		gpio-controller;
		#gpio-cells = <2>;
		gpio-ranges = <&ap_pinctrl 0 0 20>;
	};
};
```

## Documentation/devicetree/bindings/arm/marvell/armada-37xx.txt
```
Marvell Armada 37xx Platforms Device Tree Bindings
--------------------------------------------------

Boards using a SoC of the Marvell Armada 37xx family must carry the
following root node property:

 - compatible: must contain "marvell,armada3710"

In addition, boards using the Marvell Armada 3720 SoC shall have the
following property before the previous one:

 - compatible: must contain "marvell,armada3720"

Soc:
   - "marvell,armada3710"
      when the SoC being used is the Armada 3710

   - "marvell,armada3720"
      when the SoC being used is the Armada 3720

Boards:
   - "marvell,armada-3720-db"
      when the board being used is the Armada 3720 Development board

   - "marvell,armada-3720-community"
      when the board being used is the Armada 3720 Community board

Example:

compatible = "marvell,armada-3720-db", "marvell,armada3720";
```

## Documentation/devicetree/bindings/arm/marvell/armada-7k-8k.txt
```
Marvell Armada 7K/8K Platforms Device Tree Bindings
---------------------------------------------------

Boards using a SoC of the Marvell Armada 7K or 8K families must carry
the following root node property:

 - compatible, with one of the following values:

   - "marvell,armada7020", "marvell,armada-ap806-dual", "marvell,armada-ap806"
      when the SoC being used is the Armada 7020

   - "marvell,armada7040", "marvell,armada-ap806-quad", "marvell,armada-ap806"
      when the SoC being used is the Armada 7040

   - "marvell,armada8020", "marvell,armada-ap806-dual", "marvell,armada-ap806"
      when the SoC being used is the Armada 8020

   - "marvell,armada8040", "marvell,armada-ap806-quad", "marvell,armada-ap806"
      when the SoC being used is the Armada 8040

Boards:
   - "marvell,armada7040-db-default", "marvell,armada7040-db"
      when the board being used is the Armada 7040 Development board

   - "marvell,armada7040-db-B", "marvell,armada7040-db"
      when the board being used is the Armada 7040 Development board with Setup B

   - "marvell,armada7040-db-C", "marvell,armada7040-db"
      when the board being used is the Armada 7040 Development board with Setup C

   - "marvell,armada7040-db-D", "marvell,armada7040-db"
      when the board being used is the Armada 7040 Development board with Setup D

   - "marvell,armada7040-db-E", "marvell,armada7040-db"
      when the board being used is the Armada 7040 Development board with Setup E

   - "marvell,armada8040-db-default", "marvell,armada8040-db"
      when the board being used is the Armada 8040 Development board

   - "marvell,armada8040-mcbin"
      when the board being used is the MACCHIATOBin community board

   - "marvell,armada8040-mcbin-single-shot"
      when the board being used is the MACCHIATOBin single shot community board

Example:

compatible = "marvell,armada7040-db", "marvell,armada7040",
             "marvell,armada-ap806-quad", "marvell,armada-ap806";
```

## Documentation/devicetree/bindings/arm/marvell/armada-8k-plus.txt
```
Marvell Armada 8K Plus Platforms Device Tree Bindings
-----------------------------------------------------

Armada-8k-plus family will include several SoCs:
Armada-8XXY:	XX - number of cores in the SoC (e.g. 08, 16, 32)
		Y - number of CP-110 in the SoC (e.g. 1, 2, 4)
For example:
	Armada-8080: will include AP110 only with 8 cores
	Armada-8162: will include dual AP110 with 16 cores & 2 CP110
	Armada-8328: will include quad AP110 with 32 cores & 8 CP110

Boards using a SoC of the Marvell 8K Plus families must carry
the following root node property:

 - compatible, with one of the following values:

SoC:
   - "marvell,armada8080", "marvell,armada-ap810-octa", "marvell,armada-ap810"
      when the SoC being used is the Armada 8080

   - "marvell,armada8160", "marvell,armada-ap810-octa", "marvell,armada-ap810"
      when the SoC being used is the Armada 8160

   - "marvell,armada8320", "marvell,armada-ap810-octa", "marvell,armada-ap810"
      when the SoC being used is the Armada 8320

   - "marvell,armada8081", "marvell,armada-cp110", "marvell,armada-ap810-octa",
     "marvell,armada-ap810"
      when the SoC being used is the Armada 8081
      (Should add "marvell,armada-cp110" if CP110 included in the SoC)

Boards:
   - "marvell,armada-8080-pd"
      when the board being used is the Armada-8080 emulator
   - "marvell,armada-8160-pd"
      when the board being used is the Armada-8160 emulator
   - "marvell,armada-8320-pd"
      when the board being used is the Armada-8320 emulator

Example:

compatible = "marvell,armada-8080-pd", "marvell,armada-8080",
             "marvell,armada-ap810-octa", "marvell,armada-ap810";
```

## Documentation/devicetree/bindings/arm/marvell/armada-8kp.txt
```
Marvell Armada 8K Plus Platforms Device Tree Bindings
-----------------------------------------------------

Armada-8k-plus family will include several SoCs:
Armada-8XXY:	XX - number of cores in the SoC (e.g. 08, 16, 32)
		Y - number of CP-110 in the SoC (e.g. 1, 2, 4)
For example:
	Armada-8080: will include AP110 only with 8 cores
	Armada-8162: will include dual AP110 with 16 cores & 2 CP110
	Armada-8328: will include quad AP110 with 32 cores & 8 CP110

Boards using a SoC of the Marvell 8K Plus families must carry
the following root node property:

 - compatible, with one of the following values:

SoC:
   - "marvell,armada8080", "marvell,armada-ap810-octa", "marvell,armada-ap810"
      when the SoC being used is the Armada 8080

   - "marvell,armada8160", "marvell,armada-ap810-octa", "marvell,armada-ap810"
      when the SoC being used is the Armada 8160

   - "marvell,armada8320", "marvell,armada-ap810-octa", "marvell,armada-ap810"
      when the SoC being used is the Armada 8320

   - "marvell,armada8082", "marvell,armada-cp110", "marvell,armada-ap810-octa",
     "marvell,armada-ap810"
      when the SoC being used is the Armada 8082: 8 cores with 2 CP south-bridges

   - "marvell,armada8084", "marvell,armada-cp110", "marvell,armada-ap810-octa",
     "marvell,armada-ap810"
      when the SoC being used is the Armada 8084: 8 cores with 4 CP south-bridges

   - "marvell,armada8162", "marvell,armada-cp110", "marvell,armada-ap810-octa",
     "marvell,armada-ap810"
      when the SoC being used is the Armada 8162: 16 cores with 2 CP south-bridges

   - "marvell,armada8164", "marvell,armada-cp110", "marvell,armada-ap810-octa",
     "marvell,armada-ap810"
      when the SoC being used is the Armada 8164: 16 cores with 4 CP south-bridges
      (Should add "marvell,armada-cp110" if CP110 included in the SoC)

Boards:
   - "marvell,armada-8080-pd"
      when the board being used is the Armada-8080 emulator
   - "marvell,armada-8160-pd"
      when the board being used is the Armada-8160 emulator
   - "marvell,armada-8320-pd"
      when the board being used is the Armada-8320 emulator
   - "marvell,armada-8082-db"
      when the board being used is the Armada-8082 DB board
   - "marvell,armada-8082-db-B"
      when the board being used is the Armada-8082 DB board confugration "B"
   - "marvell,armada-8084-db"
      when the board being used is the Armada-8084 DB board
   - "marvell,armada-8162-db"
      when the board being used is the Armada-8162 DB board
   - "marvell,armada-8164-db"
      when the board being used is the Armada-8164 DB board

Example:
compatible = "marvell,armada-8080-pd", "marvell,armada-8080",
             "marvell,armada-ap810-octa", "marvell,armada-ap810";

compatible = "marvell,armada-8084-db", "marvell,armada-8084",
	     "marvell,armada-ap810-octa", "marvell,armada-ap810";
```

## Documentation/devicetree/bindings/arm/marvell/cn9130-armada-ep.yaml
```yaml
# SPDX-License-Identifier: (GPL-2.0-only OR BSD-2-Clause)
%YAML 1.2

title: Marvell armada-ep.

properties:
  compatible: should be "marvell,armada-ep".
  msi-parent: identifies the node as an MSI controller.

examples:
  - |
    cp0_armada_ep:armada-ep {
                compatible = "marvell,armada-ep";
                msi-parent = <&gic_v2m0>;
                status = "disabled";
    };
```

## Documentation/devicetree/bindings/arm/marvell/cn9130-dma-xor.yaml
```yaml
# SPDX-License-Identifier: (GPL-2.0-only OR BSD-2-Clause)
%YAML 1.2

title: Marvell, add dma dma_xor to cp.

properties:
  compatible: should be "marvell,mv-xor-v2-copy-offload".
  reg: reg address
  msi-parent: describes the MSI controller node.
  clocks: Desired operating frequency.
  dma-coherent: true

examples:
  -  |
     dma_xor0: dma-xor@400000 {
                compatible = "marvell,mv-xor-v2-copy-offload";
                reg = <0x400000 0x1000>,
                        <0x410000 0x1000>;
                msi-parent = <&gic_v2m0>;
                clocks = <&ap_clk 3>;
                dma-coherent;
                status = "disabled";
    };
    dma_xor1: dma-xor@420000 {
                compatible = "marvell,mv-xor-v2-copy-offload";
                reg = <0x420000 0x1000>,
                        <0x430000 0x1000>;
                msi-parent = <&gic_v2m0>;
                clocks = <&ap_clk 3>;
                dma-coherent;
                status = "disabled";
    };
```
