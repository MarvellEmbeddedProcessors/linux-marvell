## Documentation/devicetree/bindings/arm/marvell/cn9130-mdio-uio.yaml
```yaml
# SPDX-License-Identifier: (GPL-2.0-only OR BSD-2-Clause)
%YAML 1.2

title: Marvell mvmdio-uio, xmvmdio.

properties:
  compatible: should be "marvell,mvmdio-uio".
  mii-bus: These are generic properties that can apply to any MDIO bus.

examples:
  - |
    cp0_mdio_uio: mdio_uio {
                compatible = "marvell,mvmdio-uio";
                mii-bus = <&cp0_mdio>;
                status = "disabled";
    };
    cp0_xmdio_uio: xmdio_uio{
                compatible = "marvell,mvmdio-uio";
                mii-bus = <&cp0_xmdio>;
                status = "disabled";
    };
```

## Documentation/devicetree/bindings/arm/marvell/cn9130-pci-ep-uio.yaml
```yaml
# SPDX-License-Identifier: (GPL-2.0-only OR BSD-2-Clause)
%YAML 1.2

title: Marvell pci endpoint UIO

properties:
  compatible: should be "marvell,pci-ep-uio"
  reg: reg address
  reg-name: reg name

examples:
  - |
    cp0_pci_ep_uio: pci-ep-uio {
                compatible = "marvell,pci-ep-uio";
                reg = <0x00 0x00000000 0x0 0x00100000>,
                        <0x00 0x3f000000 0x0 0x01000000>,
                        <0x00 0xf0000000 0x0 0x01000000>,
                        <0x80 0x00000000 0x8 0x00000000>;
                reg-names = "bar0", "bar2", "bar4", "host-map";
                status = "disabled";
    };
```

## Documentation/devicetree/bindings/arm/marvell/cn9130-pcie-ep.yaml
```yaml
# SPDX-License-Identifier: (GPL-2.0-only OR BSD-2-Clause)
%YAML 1.2

title: Marvell pcie end point.

properties:
  compatible: should be "marvell,armada-pcie-ep", "snps,dw-pcie".
  reg: reg address
  reg-name: reg name
  clocks: supported clock.

examples:
  - |
    cp0_pcie_ep: pcie-ep@600000 {
                compatible = "marvell,armada-pcie-ep", "snps,dw-pcie";
                reg = <0 (0xf2000000 + 0x600000 + (0) * 0x4000) 0 0x4000>,
                        <0 (0xf2000000 + 0x600000 + (2) * 0x4000) 0 0x80000>,
                        <0 (0xf2000000 + 0x600000 + (1) * 0x4000) 0 0x1000>;
                reg-names = "core", "lm", "shadow_core";
                clocks = <&cp0_clk 1 13>;
                status = "disabled";
    };
```

## Documentation/devicetree/bindings/arm/marvell/msys-soc-id.txt
```
Marvell Msys SoC ID
---------------------------------------------------------------

Required properties:

- compatible: Should be "marvell,msys-soc-id".

- reg: should be the register base and length as documented in the
  datasheet for the Device ID Status

soc-id@f8244 {
	compatible = "marvell,msys-soc-id";
	reg = <0xf8244 0x4>;
};
```

## Documentation/devicetree/bindings/arm/marvell/msys.txt
```
Marvell Msys Platforms Device Tree Bindings
---------------------------------------------------------------

Boards with a SoC of the Marvell Msys families
shall have the following property:

Required root node property:

compatible: must contain "marvell,armada-370-xp"

In addition, boards using the Marvell Msys SoC shall have the
following property:

Required root node property:

compatible: must contain "marvell,msys"

In addition, boards using the Marvell Msys AlleyCat3 SoC shall have the
following property:

Required root node property:

compatible: must contain "marvell,msys-ac3"

Example:

compatible = "marvell,msys-ac3-db", "marvell,msys-ac3",
		     "marvell,msys", "marvell,armada-370-xp";

Boards using the Marvell Msys Bobcat2 SoC shall have the following property:

Required root node property:

compatible: must contain "marvell,msys-bc2"

Example:

compatible = "marvell,msys-bc2-db", "marvell,msys-bc2",
		     "marvell,msys", "marvell,armada-370-xp";

Boards using the Marvell Msys BobK SoC shall have the following property:

Required root node property:

compatible: must contain one of
	"marvell,msys-bobk-caelum", "marvell,msys-bobk-cetus",
	"marvell,msys-bobk-lewis", "marvell,msys-bobk-cygnus"

Example:

compatible = "marvell,msys-bobk-caelum-db", "marvell,msys-bobk-caelum",
		     "marvell,msys", "marvell,armada-370-xp";

compatible = "marvell,msys-bobk-cetus-db", "marvell,msys-bobk-cetus",
		     "marvell,msys", "marvell,armada-370-xp";

compatible = "marvell,msys-bobk-lewis-rd", "marvell,msys-bobk-lewis",
		     "marvell,msys", "marvell,armada-370-xp";

compatible = "marvell,msys-bobk-cygnus-rd", "marvell,msys-bobk-cygnus",
		     "marvell,msys", "marvell,armada-370-xp";
```

## Documentation/devicetree/bindings/arm/switch.txt
```
* Switch binding description

The device tree allows to describe the layout of a switch in a system through the "switch" node.


Main node required properties:

- compatible: should be "marvell,mv_switch"
- status: switch status, should be "disabled" or "okay"
- index: switch index, generally it's zero since systeem has only 1 switch generally
- phy_addr: the SMI PHY address to access switch
- gbe_port: the SOC GBE port which switch uplink port is connected to
- cpuPort: the switch port which is connect to SOC CPU
- vid: switch default DB number
- port_mask: switch port mask, if bitn is 1, then the NO. n switch port is valid in physical
- connected_port_mask: which switch ports are being used
- forced_link_port_mask: which switch ports are forced link up
- mtu: switch MTU
- smi_scan_mode: switch SMI scan mode, encoded as follows:
	0 = SMI auto scan mode, scan 0 or 0x10 base address to find the QD
	1 = SMI muanal mode, use QD located at manually defined base addr
	2 = SMI multi address mode, use QD at base addr and use indirect access
- qsgmii_module: 0 or 1, whether there is qsgmii module in switch, 0 is no, 1 is yes
- gephy_on_port: the switch GE PHY ports bitmask
- rgmiia_on_port: the switch RGMII ports bitmask, generally these ports are uplink ports
- switch_irq: if the switch use IRQ mode to report events, then switch_irq is valid and it is
	the switch IRQ number in system; if PHY polling unit is enabled and IRQ is disabled,
	the switch_irq should be 0xffffffff(-1)
- is_speed_2000: if the value is not zero, then the switch CPU port works in 2 Gbps mode
- rgmii_rx_timing_delay: RGMII receive timing control
	0 = default, there is no delay
	1 = add delay to RXCLK for IND inputs when port is in RGMII mode
- rgmii_tx_timing_delay: RGMII transmit timing control
	0 = default, there is no delay
	1 = add delay to GTXCLK for OUTD outputs when port is in RGMII mode

Example:

	In A38x mamba board,  the switch is in external mode, its SMI scan mode is multi address mode,
	and switch SMI address is 2, PHY polling unit is enabled and IRQ is disabled;
	There are 7 ports in the switch, port 5 is connected to GBE port 1 while port 6 is connected
	to the GBE port 0, switch port 6 is the CPU port, switch port 5 and 6 works in RGMII mode
	and should add delay to RXCLK for IND inputs and GTXCLK for OUTD outputs.
	Switch MTU is 1500 and switch does not works in 2G mode;

	switch {
			compatible = "marvell,mv_switch";
			status = "okay";
			index = <0x0>;
			phy_addr = <0x2>;
			gbe_port = <0x0>;
			cpuPort = <0x6>;
			vid = <0>;
			port_mask = <0x7f>;
			connected_port_mask = <0x7f>;
			forced_link_port_mask = <0x60>;
			mtu = <1500>;
			smi_scan_mode = <0x2>;
			qsgmii_module = <0>;
			gephy_on_port = <0x1f>;
			rgmiia_on_port = <0x60>;
			switch_irq = <0xffffffff>;
			is_speed_2000 = <0>;
			rgmii_rx_timing_delay = <1>;
			rgmii_tx_timing_delay = <1>;
		};
```

## Documentation/devicetree/bindings/ata/ahci-mvebu.txt
```
* Marvell EBU AHCI SATA Controller

Marvell EBU AHCI SATA Controller belongs to platform AHCI SATA
Controller; for more detailed about platform AHCI, please refer
to "ahci-platform.txt".

Required properties:
- compatible        : compatible string, one of:
  - "marvell,armada-380-ahci"
  - "marvell,armada-3700-ahci"
  - "marvell,armada-cp110-ahci"
- interrupts        : <interrupt mapping for SATA IRQ>
- reg               : <registers mapping>

Optional properties in addition to platform AHCI:
- "marvell,led-gpio"          : the GPIO which controlls LED state
- "marvell,blink-policy"      : LED blinking policy - 0 the LED is not activated on activity
                                                      1 the LED blinks on every 10ms when activity is detected.
                                                      2 the LED is on when idle, and blinks off every 10ms when activity is detected.
LED Blinking:
Marvell EBU AHCI SATA Controller supports software activity LED
blinking through a GPIO with the optional properties of "marvell,led-gpio"
and "marvell,blink-policy". The software activity LED blinking only
works when the SATA disk is connected to the controller directly,
so the 2 optional properties should not be set when a PMP card is
attached to the controller and disks are connected to the PMP card.

Example for armada 3720 DB:
        sata@e0000 {
		compatible = "marvell,armada-3700-ahci";
		reg = <0xe0000 0x178>;
		interrupts = <GIC_SPI 27 IRQ_TYPE_LEVEL_HIGH>;
		clocks = <&nb_periph_clk 1>;
		target-supply = <&reg_5v_sata>;
		phys = <&a3700_comphy 2 COMPHY_SATA0>;
		marvell,led-gpio = <&gpionb 11 GPIO_ACTIVE_LOW>;
		marvell,blink-policy = <BLINK_OFF>;
		status = "okay";
	};

Example for armada 8040 DB:
	cp0_sata: sata@540000 {
		compatible = "marvell,armada-cp110-ahci";
		reg = <0x540000 0x30000>;
		dma-coherent;
		interrupts = <ICU_GRP_NSR 107 IRQ_TYPE_LEVEL_HIGH>;
		clocks = <&cp0_syscon0 1 15>;
		comreset_u = <0x17>;
		comwake = <0x6>;
		#address-cells = <1>;
		#size-cells = <0>;

		sata-port@0 {
			reg = <0>;
			phys = <&cp0_comphy 1 COMPHY_SATA0>;
			phy-names = "comphy";
		};
		sata-port@1 {
			reg = <1>;
			phy-names = "comphy";
			status = "okay";
		};
	};
```

## Documentation/devicetree/bindings/clock/mvebu-armada-37xx-cpu-pm-clock.txt
```
* Clock bindings for Marvell MVEBU Armada 3700 CPU PM clock

The Marvell MVEBU Armada 3700 SoC contains a PMU block, used for power
management, and DFS is supported by this PMU.
This Device Tree binding allows to describe the DFS clock settings
and CPU mapping of the Armada 3700, whose frequencies are determined by
the CPU load index with PMU DFS unit.

NOTE:
When cpu_pm_clock node is enabled, and CPU clock driver initialized
successfully, it will also register and enable the cpufreq-dt generic
driver for CPU frequency scaling.


Required properties for cpu_pm_clock node:
- compatible: must be be the following:
	"marvell,armada-37xx-cpu-pm-clk"
- reg: must be the register address of the CPU Dynamic Frequency Base
	Scaling register base
- #clock-cells: from common clock binding; shall be set to 1
- #clock: pointer to CPU core clock

Required properties for CPU nodes:
- clocks: a list of phandle + clock-specifier pairs to cpu_pm_clk,
		one for each CPU node.

Example:
	cpu0: cpu@000 {
		..
		clocks = <&cpu_pm_clk 0>;
		..
	};
	cpu1: cpu@001 {
		..
		clocks = <&cpu_pm_clk 0>;
		..
	};

	cpu_pm_clk: cpu-pm-clk@14018 {
		compatible = "marvell,armada-37xx-cpu-pm-clk";
		reg = <0x14018 0x1C>;
		#clock-cells = <1>;
		clocks = <&core_clk 4>;
	};
```

## Documentation/devicetree/bindings/clock/mvebu-armada-ap806-core-clock.txt
```
* Clock bindings for Marvell MVEBU AP806 Core clocks

The Marvell MVEBU Armada 7K/8K SoCs contain a block called AP806,
hosting the CPU and other core components of the CPU. This Device Tree
binding allows to describe the core clocks of the AP806, whose
frequencies are determined by reading the Sample-At-Reset (SAR)
register.

Clock consumers must specify the desired clock by having the clock ID
in its "clocks" phandle cell.

The following is a list of provided IDs and clock names for the core
Armada AP806 clocks:

 0 = DDR
 1 = Ring
 2 = CPU

Required properties:
- compatible: must be be one of the following:
	"marvell,armada-ap806-core-clock"
- reg: must be the register address of the Sample-At-Reset (SAR) register
- #clock-cells: from common clock binding; shall be set to 1
- clock-output-names: name of the output clocks

Example:

	coreclk: clk@0x6F8204 {
		compatible = "marvell,armada-ap806-core-clock";
		reg = <0x6F8204 0x04>;
		#clock-cells = <1>;
		clock-output-names = "ddr", "ring", "cpu";
	};
```

## Documentation/devicetree/bindings/clock/mvebu-armada-ap806-cpu-clock.txt
```
* Clock bindings for Marvell MVEBU AP806 CPU clock

The Marvell MVEBU Armada 7K/8K SoCs contains a block called AP806,
hosting the CPU and other core components of the CPU.
This Device Tree binding allows to describe the AP806 CPU clock settings
and CPU mapping of the AP806, whose frequencies are determined by
reading the Sample-At-Reset (SAR)register.

NOTE:
When ap806_clock node is enabled, and CPU clock driver initialized
successfully, it will also register and enable the cpufreq-dt generic
driver for CPU frequency scaling.


Required properties for ap806_clock node:
- compatible: must be be the following:
	"marvell,ap806-cpu-clk", "syscon"
- reg: must be the register address of the CPU Dynamic Frequency Base
	Scaling register base (which is the Sample-At-Reset (SAR) register base)
- #clock-cells: from common clock binding; shall be set to 1
- #clock: pointer to "ap-cpu-cluster-0" clock entry in ap806-system-controller node

Required properties for CPU nodes:
- clocks: a list of phandle + clock-specifier pairs to ap806_clock,
		one for each CPU node.

Example:
	cpu0: cpu@000 {
		..
		clocks = <&ap806_clock 0>;
		..
	};
	cpu1: cpu@001 {
		..
		clocks = <&ap806_clock 0>;
		..
	};
	cpu2: cpu@100 {
		..
		clocks = <&ap806_clock 1>;
		..
	};
	cpu3: cpu@101 {
		..
		clocks = <&ap806_clock 1>;
		..
	};

	ap806_clock: ap806_clock {
		compatible = "marvell,ap806-cpu-clk", "syscon";
		#clock-cells = <1>;
		clocks = <&ap_syscon 0>;
		reg = <0x6f8200 0x100>;
	};
```

## Documentation/devicetree/bindings/clock/mvebu-armada-ap806-ring-clock.txt
```
* Clock bindings for Marvell MVEBU AP806 Ring clocks

The Marvell MVEBU Armada 7K/8K SoCs contain a block called AP806,
hosting the CPU and other core components of the CPU. This Device Tree
binding allows to describe the ring clocks of the AP806, which are
derived from the Ring Core clock, after a dividing factor.

The following is a list of provided IDs and clock names on Armada
AP806 RING dividers:

 0 = Ring 0
 1 = Ring 2
 2 = Ring 3
 3 = Ring 4
 4 = Ring 5

Required properties:
- compatible: must be one of the following:
	"marvell,armada-ap806-ring-clock"
- reg: must be the register holding the divider values for ring clocks
- #clock-cells : from common clock binding; shall be set to 1
- clock-output-names: name of the output clocks

Example:

	ringclk: clk@0x6F8250 {
		compatible = "marvell,armada-ap806-ring-clock";
		reg = <0x6F8250 0x04>;
		#clock-cells = <1>;
		clock-output-names = "ring-0", "ring-2", "ring-3", "ring-4", "ring-5";
		clocks = <&coreclk 1>;
	};
```

## Documentation/devicetree/bindings/clock/mvebu-armada-cp110-core-clock.txt
```
* Clock bindings for Marvell MVEBU CP110 Core clocks

The Marvell MVEBU Armada 7K/8K SoCs contain a block called CP110,
hosting slow and high speed peripherals. This Device Tree
binding allows to describe the core clocks of the CP110, whose
frequencies are fixed except for the NAND clock.

Clock consumers must specify the desired clock by having the clock ID
in its "clocks" phandle cell.

The following is a list of provided IDs and clock names for the core
Armada AP806 clocks:

 0 = APLL - The PLL clock. Root of the clock tree
 1 = PPv2 - The Packet processor clock
 2 = EIP  - The encryption engine clock
 3 = Core - The clock of all other consumers (except NAND)
 4 = Nand - The clock of the NAND interface.

Required properties:
- compatible: must be be one of the following:
	"marvell,armada-cp110-clock"
- reg: must be the register address of the NAND clock control register
- #clock-cells: from common clock binding; shall be set to 1

Example:

	cp110_clk: clk@0x6F8204 {
		compatible = "marvell,armada-cp110-clock";
		reg = <0x440700 0x4>;
		#clock-cells = <1>;
	};
```
