## Documentation/devicetree/bindings/clock/mvebu-armada3700-clock.txt
```
* Clock bindings for Marvell MVEBU Armada3700 SoCs

Marvell Armada 3700 allow some peripheral clocks to be gated to save power.The clock
consumer should specify the desired clock by having the clock ID in its
"clocks" phandle cell. The clock ID is directly mapped to the corresponding clock
gating control bit in HW to ease manual clock lookup in datasheet.

Required properties:
- compatible : shall be one of the following:
	"marvell,armada-3700-north-bridge-gating-clock" - gate clock control for Armada 3700 north bridge
	"marvell,armada-3700-south-bridge-gating-clock" - gate clock control for Armada 3700 south bridge
- reg : shall be the register address of the Clock Gating Control register
- #clock-cells : from common clock binding; shall be set to 1

Optional properties:
- clocks : default parent clock phandle and clock specifier.
	(for gate clock control, it's optional to define the parent clock,
	for the clock consumer, it defines the gate clock phandle and clock ID)

Example:

ngateclk: north-bridge-gate-clk@13014 {
	compatible = "marvell,armada-3700-north-bridge-gating-clock";
	reg = <0x13014 0x4>;
	#clock-cells = <1>;
};

sgateclk: south-bridge-gate-clk@18014 {
	compatible = "marvell,armada-3700-south-bridge-gating-clock";
	reg = <0x18014 0x4>;
	#clock-cells = <1>;
};

sata0: sata@e0000 {
	compatible = "marvell,armada-3700-ahci";
	reg = <0xe0000 0x2000>;
	interrupts = <0 27 4>;
	clocks = <&ngateclk 3>;
	status = "disabled";
};
```

## Documentation/devicetree/bindings/clock/mvebu-cpu-clock.txt
```
Device Tree Clock bindings for cpu clock of Marvell EBU platforms

Required properties:
- compatible : shall be the following:
	"marvell,armada-xp-cpu-clock" - cpu clocks for Armada XP
	"marvell,armada-38x-cpu-clock", "marvell,armada-xp-cpu-clock" - cpu
	clocks for Armada 38x
- reg : Address and length of the clock complex register set, followed
	by address and length of the PMU DFS registers, for Armada 38x
	a third register set must be addeed: DFX server.
- #clock-cells : should be set to 1.
- clocks : shall be the input parent clock phandle for the clock.

cpuclk: clock-complex@d0018700 {
	#clock-cells = <1>;
	compatible = "marvell,armada-xp-cpu-clock";
	reg = <0xd0018700 0xA0>, <0x1c054 0x10>;
	clocks = <&coreclk 1>;
}

cpu@0 {
	compatible = "marvell,sheeva-v7";
	reg = <0>;
	clocks = <&cpuclk 0>;
};

or for Armada38x

cpuclk: clock-complex@18700 {
	compatible = "marvell,armada-380-cpu-clock",
	"marvell,armada-xp-cpu-clock";
	reg = <0x18700 0xA0>, <0x1c054 0x40>,
	<0xe4260 0x8>;
	clocks = <&coreclk 1>;
	#clock-cells = <1>;
};

cpu@0 {
	device_type = "cpu";
	compatible = "arm,cortex-a9";
	reg = <0>;
	clocks = <&cpuclk 0>;
	clock-latency = <1000000>;
	clock-names = "cpu0";
};
```
