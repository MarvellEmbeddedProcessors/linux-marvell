// SPDX-License-Identifier: (GPL-2.0+ OR MIT)
/*
 * Copyright (C) 2017 Marvell Technology Group Ltd.
 *
 * Device Tree file for Marvell Armada-8080 SoC, made of an AP810 OCTA.
 */

#include "armada-ap810-ap0.dtsi"

#define AP_NUM				0
#define AP810_BASE			0xe8000000
#define AP810_GIC_ITS_BASE		0xf040000
#define AP810_EIP197_INDEX		0
#include "armada-ap810-octa-core.dtsi"
#undef AP_NUM
#undef AP810_BASE
#undef AP810_GIC_ITS_BASE
#undef AP810_EIP197_INDEX

/ {
	model = "Marvell 8080 board";
	compatible = "marvell,armada-8080", "marvell,armada-ap810-octa",
				"marvell,armada-ap810";

	aliases {
		serial0 = &ap0_uart0;
		serial1 = &ap0_uart1;
		spi0 = &ap0_spi0;
	};
};
