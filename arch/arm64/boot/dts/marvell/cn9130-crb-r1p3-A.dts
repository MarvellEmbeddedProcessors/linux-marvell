// SPDX-License-Identifier: GPL-2.0
/*
 * Copyright (C) 2023 Marvell
 *
 */

#include "cn9130-crb-A.dts"
#include "cn9130-crb-dsa.dtsi"

/ {
	model = "Marvell Armada CN9130-CRB-A (DSA)";
};

&cp0_spi1 {
	pinctrl-0 = <&cp0_spi0_pins>;
};
