/*
 * Device Tree file for Marvell AlleyCat3
 *
 * Copyright (C) 2015 Marvell
 *
 * This file is licensed under the terms of the GNU General Public
 * License version 2.  This program is licensed "as is" without any
 * warranty of any kind, whether express or implied.
 */

#include "msys.dtsi"

/ {
	model = "Marvell Msys AC3 SoC";
	compatible = "marvell,msys", "marvell,msys-ac3",
		     "marvell,armada-370-xp";

	soc {
		internal-regs {
			pinctrl@18000 {
				compatible = "marvell,ac3-pinctrl";
			};
		};
	};
};
